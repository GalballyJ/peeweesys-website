ASAP2_VERSION 1 61
/begin PROJECT ME72_986BoxsterS "Porsche 986 Boxster S ME7.2 ROM 91003718 - UNVERIFIED_CANDIDATES_FileOffset"
/begin MODULE ME72 "ME7.2 3.2L Calibration"
/begin MOD_COMMON "Bosch ME7.2 C167CR Little Endian" BYTE_ORDER MSB_LAST ALIGNMENT_BYTE 1 ALIGNMENT_WORD 1 ALIGNMENT_LONG 1 /end MOD_COMMON
/begin COMPU_METHOD CM_IDENT_UNIT_0 "Direct -" IDENTICAL "%.0f" "-" /end COMPU_METHOD
/begin COMPU_METHOD CM_LIN_tmot_coolant_deg_1 "Linear tmot (coolant deg C)" LINEAR "%.2f" "tmot (coolant deg C)" COEFFS_LINEAR 0.75 -48 /end COMPU_METHOD
/begin COMPU_METHOD CM_LIN_tmst_start_deg_C_2 "Linear tmst (start deg C)" LINEAR "%.2f" "tmst (start deg C)" COEFFS_LINEAR 0.75 -48 /end COMPU_METHOD
/begin COMPU_METHOD CM_LIN_nmot_RPM_3 "Linear nmot (RPM)" LINEAR "%.1f" "nmot (RPM)" COEFFS_LINEAR 40 0 /end COMPU_METHOD
/begin COMPU_METHOD CM_LIN_lambas_AFR_4 "Linear lambas (AFR)" LINEAR "%.3f" "lambas (AFR)" COEFFS_LINEAR 0.0078125 0 /end COMPU_METHOD
/begin COMPU_METHOD CM_IDENT_frhokor_cat_heat_5 "Direct frhokor (cat heating step)" IDENTICAL "%.0f" "frhokor (cat heating step)" /end COMPU_METHOD
/begin COMPU_METHOD CM_LIN_tateroh_purge_fl_6 "Linear tateroh (% purge flow)" LINEAR "%.2f" "tateroh (% purge flow)" COEFFS_LINEAR 0.3921568627 0 /end COMPU_METHOD
/begin COMPU_METHOD CM_LIN_nmot_ub_q40_7 "Linear nmot_ub_q40" LINEAR "%.1f" "nmot_ub_q40" COEFFS_LINEAR 40 0 /end COMPU_METHOD
/begin COMPU_METHOD CM_LIN_rel_ub_q0p75_8 "Linear rel_ub_q0p75" LINEAR "%.2f" "rel_ub_q0p75" COEFFS_LINEAR 0.75 0 /end COMPU_METHOD
/begin COMPU_METHOD CM_LIN_tkatmf_temp_deg__9 "Linear tkatmf (temp deg C)" LINEAR "%.1f" "tkatmf (temp deg C)" COEFFS_LINEAR 5 -50 /end COMPU_METHOD
/begin COMPU_METHOD CM_LIN_phlsnhf_flow_fac_10 "Linear phlsnhf (flow factor)" LINEAR "%.3f" "phlsnhf (flow factor)" COEFFS_LINEAR 0.01 0 /end COMPU_METHOD
/begin COMPU_METHOD CM_LIN_tkatmf2_temp_deg_11 "Linear tkatmf2 (temp deg C)" LINEAR "%.1f" "tkatmf2 (temp deg C)" COEFFS_LINEAR 5 -50 /end COMPU_METHOD
/begin COMPU_METHOD CM_LIN_phlsnhf2_flow_fa_12 "Linear phlsnhf2 (flow factor)" LINEAR "%.3f" "phlsnhf2 (flow factor)" COEFFS_LINEAR 0.01 0 /end COMPU_METHOD
/begin COMPU_METHOD CM_LIN_mifa_torque_13 "Linear mifa (torque %)" LINEAR "%.3f" "mifa (torque %)" COEFFS_LINEAR 0.0078125 0 /end COMPU_METHOD
/begin COMPU_METHOD CM_LIN_tevfa_inj_time_r_14 "Linear tevfa (inj time raw)" LINEAR "%.3f" "tevfa (inj time raw)" COEFFS_LINEAR 0.0078125 0 /end COMPU_METHOD
/begin COMPU_METHOD CM_LIN_spg_ubatt_15 "Linear spg_ubatt" LINEAR "%.2f" "spg_ubatt" COEFFS_LINEAR 0.076 0 /end COMPU_METHOD
/begin COMPU_METHOD CM_IDENT_dez_16 "Direct dez" IDENTICAL "%.0f" "dez" /end COMPU_METHOD
/begin COMPU_METHOD CM_LIN_rel_ub_b127p5_17 "Linear rel_ub_b127p5" LINEAR "%.2f" "rel_ub_b127p5" COEFFS_LINEAR 0.5 0 /end COMPU_METHOD
/begin COMPU_METHOD CM_LIN_m_q0p1_18 "Linear m_q0p1" LINEAR "%.2f" "m_q0p1" COEFFS_LINEAR 0.1 0 /end COMPU_METHOD
/begin COMPU_METHOD CM_LIN_rel_ub_b99p6_19 "Linear rel_ub_b99p6" LINEAR "%.2f" "rel_ub_b99p6" COEFFS_LINEAR 0.390625 0 /end COMPU_METHOD
/begin COMPU_METHOD CM_LIN_m_ub_b1020_20 "Linear m_ub_b1020" LINEAR "%.1f" "m_ub_b1020" COEFFS_LINEAR 4 0 /end COMPU_METHOD
/begin COMPU_METHOD CM_LIN_wnwue_w_cam_deg__21 "Linear wnwue_w (cam deg KW)" LINEAR "%.4f" "wnwue_w (cam deg KW)" COEFFS_LINEAR 0.0019 0 /end COMPU_METHOD
/begin COMPU_METHOD CM_LIN_nmot_w_RPM_22 "Linear nmot_w (RPM)" LINEAR "%.2f" "nmot_w (RPM)" COEFFS_LINEAR 0.25 0 /end COMPU_METHOD
/begin COMPU_METHOD CM_LIN_ub_battery_V_23 "Linear ub (battery V)" LINEAR "%.4f" "ub (battery V)" COEFFS_LINEAR 0.00244140625 0 /end COMPU_METHOD
/begin COMPU_METHOD CM_LIN_rlnw_w_load_24 "Linear rlnw_w (load %)" LINEAR "%.3f" "rlnw_w (load %)" COEFFS_LINEAR 0.0234375 0 /end COMPU_METHOD
/begin COMPU_METHOD CM_LIN_nmot_25 "Linear nmot" LINEAR "%.1f" "nmot" COEFFS_LINEAR 40 0 /end COMPU_METHOD
/begin COMPU_METHOD CM_LIN_tkatmf_26 "Linear tkatmf" LINEAR "%.1f" "tkatmf" COEFFS_LINEAR 5 -50 /end COMPU_METHOD
/begin COMPU_METHOD CM_IDENT_s_27 "Direct s" IDENTICAL "%.0f" "s" /end COMPU_METHOD
/begin COMPU_METHOD CM_LIN_MDNORM_28 "Linear % MDNORM" LINEAR "%.2f" "% MDNORM" COEFFS_LINEAR 0.125 0 /end COMPU_METHOD
/begin COMPU_METHOD CM_LIN_UNIT_29 "Linear -" LINEAR "%.3f" "-" COEFFS_LINEAR 0.0078125 0 /end COMPU_METHOD
/begin COMPU_METHOD CM_LIN_warmup_factor_30 "Linear warmup factor" LINEAR "%.3f" "warmup factor" COEFFS_LINEAR 0.0078125 0 /end COMPU_METHOD
/begin COMPU_METHOD CM_LIN_s_31 "Linear s" LINEAR "%.3f" "s" COEFFS_LINEAR 0.01 0 /end COMPU_METHOD
/begin COMPU_METHOD CM_IDENT_Grad_C_32 "Direct Grad C" IDENTICAL "%.0f" "Grad C" /end COMPU_METHOD
/begin COMPU_METHOD CM_LIN_s_33 "Linear s" LINEAR "%.3f" "s" COEFFS_LINEAR 0.02 0 /end COMPU_METHOD
/begin COMPU_METHOD CM_IDENT_UNIT_34 "Direct %" IDENTICAL "%.0f" "%" /end COMPU_METHOD
/begin COMPU_METHOD CM_LIN_Umdr_sec_2_35 "Linear (Umdr./sec)^2" LINEAR "%.1f" "(Umdr./sec)^2" COEFFS_LINEAR 1.09951 0 /end COMPU_METHOD
/begin COMPU_METHOD CM_LIN_grad_KW_36 "Linear grad KW" LINEAR "%.2f" "grad KW" COEFFS_LINEAR -0.75 0 /end COMPU_METHOD
/begin COMPU_METHOD CM_LIN_factor_37 "Linear factor" LINEAR "%.3f" "factor" COEFFS_LINEAR 0.0078125 0 /end COMPU_METHOD
/begin COMPU_METHOD CM_IDENT_Umdr_sec_2_38 "Direct (Umdr./sec)^2" IDENTICAL "%.0f" "(Umdr./sec)^2" /end COMPU_METHOD
/begin COMPU_METHOD CM_LIN_deg_BTDC_retard_39 "Linear deg BTDC retard" LINEAR "%.2f" "deg BTDC retard" COEFFS_LINEAR 0.75 -96 /end COMPU_METHOD
/begin COMPU_METHOD CM_LIN_UNIT_40 "Linear %" LINEAR "%.2f" "%" COEFFS_LINEAR 0.390625 0 /end COMPU_METHOD
/begin COMPU_METHOD CM_IDENT_Upm_41 "Direct Upm" IDENTICAL "%.0f" "Upm" /end COMPU_METHOD
/begin COMPU_METHOD CM_IDENT_RPM_correction_l_42 "Direct RPM (correction/limit offset)" IDENTICAL "%.0f" "RPM (correction/limit offset)" /end COMPU_METHOD
/begin COMPU_METHOD CM_IDENT_ms_43 "Direct ms" IDENTICAL "%.0f" "ms" /end COMPU_METHOD
/begin COMPU_METHOD CM_IDENT_rpm_scaled_inter_44 "Direct rpm (scaled internal units)" IDENTICAL "%.0f" "rpm (scaled internal units)" /end COMPU_METHOD
/begin COMPU_METHOD CM_IDENT_10ms_centisecond_45 "Direct 10ms (centiseconds)" IDENTICAL "%.0f" "10ms (centiseconds)" /end COMPU_METHOD
/begin COMPU_METHOD CM_IDENT_Nm_signed_torque_46 "Direct Nm (signed torque correction)" IDENTICAL "%.0f" "Nm (signed torque correction)" /end COMPU_METHOD
/begin COMPU_METHOD CM_IDENT_0_1_correction_f_47 "Direct 0.1% correction factor (dimensionless gain)" IDENTICAL "%.0f" "0.1% correction factor (dimensionless gain)" /end COMPU_METHOD
/begin COMPU_METHOD CM_IDENT_0_1_48 "Direct 0.1%" IDENTICAL "%.0f" "0.1%" /end COMPU_METHOD
/begin COMPU_METHOD CM_IDENT_rpm_49 "Direct rpm" IDENTICAL "%.0f" "rpm" /end COMPU_METHOD
/begin COMPU_METHOD CM_IDENT_RPM_s_rate_limit_50 "Direct RPM/s (rate limit gain)" IDENTICAL "%.0f" "RPM/s (rate limit gain)" /end COMPU_METHOD
/begin COMPU_METHOD CM_IDENT_rpm_s_jerk_limit_51 "Direct rpm/s (jerk limit)" IDENTICAL "%.0f" "rpm/s (jerk limit)" /end COMPU_METHOD
/begin COMPU_METHOD CM_IDENT_rpm_10_52 "Direct rpm (×10)" IDENTICAL "%.0f" "rpm (×10)" /end COMPU_METHOD
/begin COMPU_METHOD CM_LIN_deg_CRK_53 "Linear deg CRK" LINEAR "%.2f" "deg CRK" COEFFS_LINEAR 0.75 -96 /end COMPU_METHOD
/begin COMPU_METHOD CM_LIN_UNIT_54 "Linear -" LINEAR "%.4f" "-" COEFFS_LINEAR 0.00390625 0 /end COMPU_METHOD
/begin COMPU_METHOD CM_IDENT_U_min_55 "Direct U/min" IDENTICAL "%.0f" "U/min" /end COMPU_METHOD
/begin COMPU_METHOD CM_IDENT_factor_1_256_sca_56 "Direct factor (1/256 scale)" IDENTICAL "%.0f" "factor (1/256 scale)" /end COMPU_METHOD
/begin COMPU_METHOD CM_IDENT_camshaft_angle_o_57 "Direct ° (camshaft angle offset)" IDENTICAL "%.0f" "° (camshaft angle offset)" /end COMPU_METHOD
/begin COMPU_METHOD CM_LIN_UNIT_58 "Linear %" LINEAR "%.2f" "%" COEFFS_LINEAR -0.09764705882 0 /end COMPU_METHOD
/begin COMPU_METHOD CM_IDENT_grad_KW_59 "Direct grad KW" IDENTICAL "%.0f" "grad KW" /end COMPU_METHOD
/begin COMPU_METHOD CM_LIN_UNIT_60 "Linear -" LINEAR "%.4f" "-" COEFFS_LINEAR 7.629394531e-05 0 /end COMPU_METHOD
/begin COMPU_METHOD CM_LIN_UNIT_61 "Linear -" LINEAR "%.3f" "-" COEFFS_LINEAR 0.015625 0 /end COMPU_METHOD
/begin COMPU_METHOD CM_LIN_RPM_idle_target_62 "Linear RPM idle target" LINEAR "%.1f" "RPM idle target" COEFFS_LINEAR 10 0 /end COMPU_METHOD
/begin COMPU_METHOD CM_IDENT_s_kg_h_63 "Direct %/(s*kg/h)" IDENTICAL "%.0f" "%/(s*kg/h)" /end COMPU_METHOD
/begin COMPU_METHOD CM_LIN_UNIT_64 "Linear -" LINEAR "%.4f" "-" COEFFS_LINEAR 0.000244140625 0 /end COMPU_METHOD
/begin COMPU_METHOD CM_LIN_ms_period_65 "Linear ms period" LINEAR "%.2f" "ms period" COEFFS_LINEAR 0.5 0 /end COMPU_METHOD
/begin COMPU_METHOD CM_IDENT_us_66 "Direct us" IDENTICAL "%.0f" "us" /end COMPU_METHOD
/begin COMPU_METHOD CM_LIN_ohms_resistance_67 "Linear ohms resistance" LINEAR "%.1f" "ohms resistance" COEFFS_LINEAR 8 0 /end COMPU_METHOD
/begin COMPU_METHOD CM_IDENT_ignitions_68 "Direct ignitions" IDENTICAL "%.0f" "ignitions" /end COMPU_METHOD
/begin COMPU_METHOD CM_IDENT_codeword_69 "Direct codeword" IDENTICAL "%.0f" "codeword" /end COMPU_METHOD
/begin COMPU_METHOD CM_LIN_RPM_70 "Linear RPM" LINEAR "%.1f" "RPM" COEFFS_LINEAR 40 0 /end COMPU_METHOD
/begin COMPU_METHOD CM_LIN_torque_reserve_71 "Linear torque reserve %" LINEAR "%.3f" "torque reserve %" COEFFS_LINEAR 0.0078125 0 /end COMPU_METHOD
/begin COMPU_METHOD CM_LIN_correction_facto_72 "Linear correction factor" LINEAR "%.3f" "correction factor" COEFFS_LINEAR 0.0078125 0 /end COMPU_METHOD
/begin COMPU_METHOD CM_LIN_ms_73 "Linear ms" LINEAR "%.2f" "ms" COEFFS_LINEAR 0.1 0 /end COMPU_METHOD
/begin COMPU_METHOD CM_LIN_UNIT_74 "Linear %" LINEAR "%.2f" "%" COEFFS_LINEAR 0.195 0 /end COMPU_METHOD
/begin COMPU_METHOD CM_IDENT_U_min_s_75 "Direct %/(U/min)/s" IDENTICAL "%.0f" "%/(U/min)/s" /end COMPU_METHOD
/begin COMPU_METHOD CM_IDENT_flag_0_off_1_on_76 "Direct flag (0=off, 1=on)" IDENTICAL "%.0f" "flag (0=off, 1=on)" /end COMPU_METHOD
/begin COMPU_METHOD CM_LIN_UNIT_77 "Linear %" LINEAR "%.2f" "%" COEFFS_LINEAR 0.5 0 /end COMPU_METHOD
/begin COMPU_METHOD CM_LIN_s_78 "Linear s" LINEAR "%.2f" "s" COEFFS_LINEAR 0.1 0 /end COMPU_METHOD
/begin COMPU_METHOD CM_IDENT_s_79 "Direct %/s" IDENTICAL "%.0f" "%/s" /end COMPU_METHOD
/begin COMPU_METHOD CM_LIN_ms_s_80 "Linear ms/s" LINEAR "%.3f" "ms/s" COEFFS_LINEAR 0.0390625 0 /end COMPU_METHOD
/begin COMPU_METHOD CM_LIN_UNIT_81 "Linear -" LINEAR "%.2f" "-" COEFFS_LINEAR 0.125 0 /end COMPU_METHOD
/begin COMPU_METHOD CM_LIN_factor_82 "Linear factor" LINEAR "%.4f" "factor" COEFFS_LINEAR 4.5776e-06 0 /end COMPU_METHOD
/begin COMPU_METHOD CM_LIN_ms_dwell_83 "Linear ms dwell" LINEAR "%.3f" "ms dwell" COEFFS_LINEAR 0.01 0 /end COMPU_METHOD
/begin COMPU_METHOD CM_LIN_UNIT_84 "Linear -" LINEAR "%.4f" "-" COEFFS_LINEAR 3.051757812e-05 0 /end COMPU_METHOD
/begin COMPU_METHOD CM_LIN_UNIT_85 "Linear %" LINEAR "%.2f" "%" COEFFS_LINEAR 0.09764705882 0 /end COMPU_METHOD
/begin COMPU_METHOD CM_LIN_deg_BTDC_delta_86 "Linear deg BTDC delta" LINEAR "%.2f" "deg BTDC delta" COEFFS_LINEAR 0.75 0 /end COMPU_METHOD
/begin COMPU_METHOD CM_LIN_deg_KW_cam_sprea_87 "Linear deg KW cam spread" LINEAR "%.3f" "deg KW cam spread" COEFFS_LINEAR 0.0078125 0 /end COMPU_METHOD
/begin COMPU_METHOD CM_IDENT_km_h_88 "Direct km/h" IDENTICAL "%.0f" "km/h" /end COMPU_METHOD
/begin COMPU_METHOD CM_LIN_UNIT_89 "Linear -" LINEAR "%.2f" "-" COEFFS_LINEAR 0.0625 0 /end COMPU_METHOD
/begin COMPU_METHOD CM_LIN_UNIT_90 "Linear -" LINEAR "%.2f" "-" COEFFS_LINEAR 0.076 0 /end COMPU_METHOD
/begin COMPU_METHOD CM_LIN_UNIT_91 "Linear -" LINEAR "%.3f" "-" COEFFS_LINEAR 0.01 0 /end COMPU_METHOD
/begin COMPU_METHOD CM_LIN_UNIT_92 "Linear -" LINEAR "%.2f" "-" COEFFS_LINEAR 0.75 0 /end COMPU_METHOD
/begin COMPU_METHOD CM_LIN_UNIT_93 "Linear -" LINEAR "%.2f" "-" COEFFS_LINEAR 0.392157 0 /end COMPU_METHOD
/begin COMPU_METHOD CM_LIN_UNIT_94 "Linear -" LINEAR "%.2f" "-" COEFFS_LINEAR 0.75 -48 /end COMPU_METHOD
/begin COMPU_METHOD CM_LIN_UNIT_95 "Linear -" LINEAR "%.4f" "-" COEFFS_LINEAR 0.0015259 0 /end COMPU_METHOD
/begin COMPU_METHOD CM_LIN_UNIT_96 "Linear -" LINEAR "%.4f" "-" COEFFS_LINEAR 0.00488281 -1 /end COMPU_METHOD
/begin COMPU_METHOD CM_LIN_UNIT_97 "Linear -" LINEAR "%.1f" "-" COEFFS_LINEAR 1.25 0 /end COMPU_METHOD
/begin COMPU_METHOD CM_LIN_UNIT_98 "Linear -" LINEAR "%.1f" "-" COEFFS_LINEAR 25 0 /end COMPU_METHOD
/begin COMPU_METHOD CM_LIN_UNIT_99 "Linear -" LINEAR "%.3f" "-" COEFFS_LINEAR 0.02 0 /end COMPU_METHOD
/begin COMPU_METHOD CM_LIN_UNIT_100 "Linear -" LINEAR "%.3f" "-" COEFFS_LINEAR 0.0146484 0 /end COMPU_METHOD
/begin COMPU_METHOD CM_LIN_UNIT_101 "Linear -" LINEAR "%.4f" "-" COEFFS_LINEAR 0.00305176 0 /end COMPU_METHOD
/begin COMPU_METHOD CM_LIN_UNIT_102 "Linear -" LINEAR "%.1f" "-" COEFFS_LINEAR 40 0 /end COMPU_METHOD
/begin COMPU_METHOD CM_LIN_UNIT_103 "Linear -" LINEAR "%.2f" "-" COEFFS_LINEAR 0.1 0 /end COMPU_METHOD
/begin COMPU_METHOD CM_LIN_UNIT_104 "Linear -" LINEAR "%.2f" "-" COEFFS_LINEAR 0.390625 0 /end COMPU_METHOD
/begin COMPU_METHOD CM_LIN_UNIT_105 "Linear -" LINEAR "%.4f" "-" COEFFS_LINEAR 0.00238281 0 /end COMPU_METHOD
/begin COMPU_METHOD CM_LIN_UNIT_106 "Linear -" LINEAR "%.2f" "-" COEFFS_LINEAR 0.909496 0 /end COMPU_METHOD
/begin COMPU_METHOD CM_LIN_UNIT_107 "Linear -" LINEAR "%.1f" "-" COEFFS_LINEAR 20 0 /end COMPU_METHOD
/begin COMPU_METHOD CM_LIN_UNIT_108 "Linear -" LINEAR "%.2f" "-" COEFFS_LINEAR 0.2 0 /end COMPU_METHOD
/begin COMPU_METHOD CM_LIN_UNIT_109 "Linear -" LINEAR "%.3f" "-" COEFFS_LINEAR 0.019 0 /end COMPU_METHOD
/begin COMPU_METHOD CM_LIN_UNIT_110 "Linear -" LINEAR "%.3f" "-" COEFFS_LINEAR 0.0390625 0 /end COMPU_METHOD
/begin COMPU_METHOD CM_LIN_UNIT_111 "Linear -" LINEAR "%.4f" "-" COEFFS_LINEAR 0.00152588 0 /end COMPU_METHOD
/begin COMPU_METHOD CM_LIN_UNIT_112 "Linear -" LINEAR "%.2f" "-" COEFFS_LINEAR 0.5 0 /end COMPU_METHOD
/begin COMPU_METHOD CM_LIN_UNIT_113 "Linear -" LINEAR "%.2f" "-" COEFFS_LINEAR 0.25 0 /end COMPU_METHOD
/begin RECORD_LAYOUT RL_UBYTE FNC_VALUES 1 UBYTE ROW_DIR DIRECT /end RECORD_LAYOUT
/begin RECORD_LAYOUT RL_SBYTE FNC_VALUES 1 SBYTE ROW_DIR DIRECT /end RECORD_LAYOUT
/begin RECORD_LAYOUT RL_UWORD FNC_VALUES 1 UWORD ROW_DIR DIRECT /end RECORD_LAYOUT
/begin RECORD_LAYOUT RL_SWORD FNC_VALUES 1 SWORD ROW_DIR DIRECT /end RECORD_LAYOUT
/begin RECORD_LAYOUT RL_AXIS_UBYTE AXIS_PTS_X 1 UBYTE INDEX_INCR DIRECT /end RECORD_LAYOUT
/begin RECORD_LAYOUT RL_AXIS_SBYTE AXIS_PTS_X 1 SBYTE INDEX_INCR DIRECT /end RECORD_LAYOUT
/begin RECORD_LAYOUT RL_AXIS_UWORD AXIS_PTS_X 1 UWORD INDEX_INCR DIRECT /end RECORD_LAYOUT
/begin RECORD_LAYOUT RL_AXIS_SWORD AXIS_PTS_X 1 SWORD INDEX_INCR DIRECT /end RECORD_LAYOUT
/begin AXIS_PTS AXIS_TVSATEM_X "TVSATEM X Axis (-)" 0x010020 NO_INPUT_QUANTITY RL_AXIS_UBYTE 0 CM_IDENT_UNIT_0 6 0.0 255.0 DEPOSIT ABSOLUT /end AXIS_PTS
/begin AXIS_PTS AXIS_KFDWTBR2_X "KFDWTBR2 X Axis (-)" 0x0104C3 NO_INPUT_QUANTITY RL_AXIS_UBYTE 0 CM_IDENT_UNIT_0 10 0.0 255.0 DEPOSIT ABSOLUT /end AXIS_PTS
/begin AXIS_PTS AXIS_KFFWL_X "KFFWL X Axis (tmot (coolant deg C))" 0x01053E NO_INPUT_QUANTITY RL_AXIS_UBYTE 0 CM_LIN_tmot_coolant_deg_1 12 -48.0 143.25 DEPOSIT ABSOLUT /end AXIS_PTS
/begin AXIS_PTS AXIS_KFFWL_Y "KFFWL Y Axis (tmst (start deg C))" 0x01054A NO_INPUT_QUANTITY RL_AXIS_UBYTE 0 CM_LIN_tmst_start_deg_C_2 12 -48.0 143.25 DEPOSIT ABSOLUT /end AXIS_PTS
/begin AXIS_PTS AXIS_KLTNMXPR_X "KLTNMXPR X Axis (-)" 0x010601 NO_INPUT_QUANTITY RL_AXIS_UBYTE 0 CM_IDENT_UNIT_0 8 0.0 255.0 DEPOSIT ABSOLUT /end AXIS_PTS
/begin AXIS_PTS AXIS_DTUMTAT_X "DTUMTAT X Axis (-)" 0x010624 NO_INPUT_QUANTITY RL_AXIS_UBYTE 0 CM_IDENT_UNIT_0 5 0.0 255.0 DEPOSIT ABSOLUT /end AXIS_PTS
/begin AXIS_PTS AXIS_ZKFNS_X "ZKFNS X Axis (-)" 0x010631 NO_INPUT_QUANTITY RL_AXIS_UBYTE 0 CM_IDENT_UNIT_0 7 0.0 255.0 DEPOSIT ABSOLUT /end AXIS_PTS
/begin AXIS_PTS AXIS_ZVNWVS_X "ZVNWVS X Axis (-)" 0x010694 NO_INPUT_QUANTITY RL_AXIS_UBYTE 0 CM_IDENT_UNIT_0 8 0.0 255.0 DEPOSIT ABSOLUT /end AXIS_PTS
/begin AXIS_PTS AXIS_KRMXN_X "KRMXN X Axis (-)" 0x010E3D NO_INPUT_QUANTITY RL_AXIS_UBYTE 0 CM_IDENT_UNIT_0 14 0.0 255.0 DEPOSIT ABSOLUT /end AXIS_PTS
/begin AXIS_PTS AXIS_FRLMNHO_X "FRLMNHO X Axis (-)" 0x0112BE NO_INPUT_QUANTITY RL_AXIS_UBYTE 0 CM_IDENT_UNIT_0 5 0.0 255.0 DEPOSIT ABSOLUT /end AXIS_PTS
/begin AXIS_PTS AXIS_DLURMIN_X "DLURMIN X Axis (-)" 0x0112DA NO_INPUT_QUANTITY RL_AXIS_UBYTE 0 CM_IDENT_UNIT_0 4 0.0 255.0 DEPOSIT ABSOLUT /end AXIS_PTS
/begin AXIS_PTS AXIS_KFDZWKG_X "KFDZWKG X Axis (nmot (RPM))" 0x011347 NO_INPUT_QUANTITY RL_AXIS_UBYTE 0 CM_LIN_nmot_RPM_3 8 0.0 10200.0 DEPOSIT ABSOLUT /end AXIS_PTS
/begin AXIS_PTS AXIS_KFDZWKG_Y "KFDZWKG Y Axis (lambas (AFR))" 0x01134F NO_INPUT_QUANTITY RL_AXIS_UBYTE 0 CM_LIN_lambas_AFR_4 5 0.0 1.9922 DEPOSIT ABSOLUT /end AXIS_PTS
/begin AXIS_PTS AXIS_TVKTDTK_X "TVKTDTK X Axis (-)" 0x0113CB NO_INPUT_QUANTITY RL_AXIS_UBYTE 0 CM_IDENT_UNIT_0 4 0.0 255.0 DEPOSIT ABSOLUT /end AXIS_PTS
/begin AXIS_PTS AXIS_KFNWADGE_X "KFNWADGE X Axis (-)" 0x01141A NO_INPUT_QUANTITY RL_AXIS_UBYTE 0 CM_IDENT_UNIT_0 4 0.0 255.0 DEPOSIT ABSOLUT /end AXIS_PTS
/begin AXIS_PTS AXIS_TANDT_X "TANDT X Axis (-)" 0x01148F NO_INPUT_QUANTITY RL_AXIS_UBYTE 0 CM_IDENT_UNIT_0 8 0.0 255.0 DEPOSIT ABSOLUT /end AXIS_PTS
/begin AXIS_PTS AXIS_MDLF2_X "MDLF2 X Axis (-)" 0x01155F NO_INPUT_QUANTITY RL_AXIS_UBYTE 0 CM_IDENT_UNIT_0 4 0.0 255.0 DEPOSIT ABSOLUT /end AXIS_PTS
/begin AXIS_PTS AXIS_KFNSTAMX_X "KFNSTAMX X Axis (-)" 0x01155F NO_INPUT_QUANTITY RL_AXIS_UBYTE 0 CM_IDENT_UNIT_0 4 0.0 255.0 DEPOSIT ABSOLUT /end AXIS_PTS
/begin AXIS_PTS AXIS_KFNSTAMX_Y "KFNSTAMX Y Axis (-)" 0x011563 NO_INPUT_QUANTITY RL_AXIS_UBYTE 0 CM_IDENT_UNIT_0 4 0.0 255.0 DEPOSIT ABSOLUT /end AXIS_PTS
/begin AXIS_PTS AXIS_DNARAU_X "DNARAU X Axis (-)" 0x0117E3 NO_INPUT_QUANTITY RL_AXIS_UBYTE 0 CM_IDENT_UNIT_0 4 0.0 255.0 DEPOSIT ABSOLUT /end AXIS_PTS
/begin AXIS_PTS AXIS_KFMI_UM_X "KFMI_UM X Axis (-)" 0x011B3E NO_INPUT_QUANTITY RL_AXIS_UBYTE 0 CM_IDENT_UNIT_0 8 0.0 255.0 DEPOSIT ABSOLUT /end AXIS_PTS
/begin AXIS_PTS AXIS_SALUNKH_X "SALUNKH X Axis (-)" 0x011B47 NO_INPUT_QUANTITY RL_AXIS_UBYTE 0 CM_IDENT_UNIT_0 8 0.0 255.0 DEPOSIT ABSOLUT /end AXIS_PTS
/begin AXIS_PTS AXIS_KFVAKLK_X "KFVAKLK X Axis (-)" 0x011CB3 NO_INPUT_QUANTITY RL_AXIS_UBYTE 0 CM_IDENT_UNIT_0 8 0.0 255.0 DEPOSIT ABSOLUT /end AXIS_PTS
/begin AXIS_PTS AXIS_KLNPED_UC_X "KLNPED_UC X Axis (-)" 0x011CBF NO_INPUT_QUANTITY RL_AXIS_UBYTE 0 CM_IDENT_UNIT_0 8 0.0 255.0 DEPOSIT ABSOLUT /end AXIS_PTS
/begin AXIS_PTS AXIS_NSTMXM_X "NSTMXM X Axis (-)" 0x011CD7 NO_INPUT_QUANTITY RL_AXIS_UBYTE 0 CM_IDENT_UNIT_0 4 0.0 255.0 DEPOSIT ABSOLUT /end AXIS_PTS
/begin AXIS_PTS AXIS_PLRHAV_X "PLRHAV X Axis (-)" 0x011D39 NO_INPUT_QUANTITY RL_AXIS_UBYTE 0 CM_IDENT_UNIT_0 8 0.0 255.0 DEPOSIT ABSOLUT /end AXIS_PTS
/begin AXIS_PTS AXIS_CRTVMAX_X "CRTVMAX X Axis (-)" 0x0122AE NO_INPUT_QUANTITY RL_AXIS_UBYTE 0 CM_IDENT_UNIT_0 4 0.0 255.0 DEPOSIT ABSOLUT /end AXIS_PTS
/begin AXIS_PTS AXIS_LIMNDTES_X "LIMNDTES X Axis (-)" 0x012DB1 NO_INPUT_QUANTITY RL_AXIS_UBYTE 0 CM_IDENT_UNIT_0 4 0.0 255.0 DEPOSIT ABSOLUT /end AXIS_PTS
/begin AXIS_PTS AXIS_FSZTM_X "FSZTM X Axis (-)" 0x0142ED NO_INPUT_QUANTITY RL_AXIS_UBYTE 0 CM_IDENT_UNIT_0 8 0.0 255.0 DEPOSIT ABSOLUT /end AXIS_PTS
/begin AXIS_PTS AXIS_DZWOAGR_X "DZWOAGR X Axis (-)" 0x01433F NO_INPUT_QUANTITY RL_AXIS_UBYTE 0 CM_IDENT_UNIT_0 10 0.0 255.0 DEPOSIT ABSOLUT /end AXIS_PTS
/begin AXIS_PTS AXIS_MDSNWUE_X "MDSNWUE X Axis (-)" 0x014355 NO_INPUT_QUANTITY RL_AXIS_UBYTE 0 CM_IDENT_UNIT_0 10 0.0 255.0 DEPOSIT ABSOLUT /end AXIS_PTS
/begin AXIS_PTS AXIS_KFRAT_X "KFRAT X Axis (-)" 0x015E47 NO_INPUT_QUANTITY RL_AXIS_UBYTE 0 CM_IDENT_UNIT_0 5 0.0 255.0 DEPOSIT ABSOLUT /end AXIS_PTS
/begin AXIS_PTS AXIS_KFESFSAM_X "KFESFSAM X Axis (-)" 0x016038 NO_INPUT_QUANTITY RL_AXIS_UBYTE 0 CM_IDENT_UNIT_0 5 0.0 255.0 DEPOSIT ABSOLUT /end AXIS_PTS
/begin AXIS_PTS AXIS_KFFFANZ_X "KFFFANZ X Axis (-)" 0x016036 NO_INPUT_QUANTITY RL_AXIS_UBYTE 0 CM_IDENT_UNIT_0 8 0.0 255.0 DEPOSIT ABSOLUT /end AXIS_PTS
/begin AXIS_PTS AXIS_KFFFANZ_Y "KFFFANZ Y Axis (-)" 0x01603E NO_INPUT_QUANTITY RL_AXIS_UBYTE 0 CM_IDENT_UNIT_0 8 0.0 255.0 DEPOSIT ABSOLUT /end AXIS_PTS
/begin AXIS_PTS AXIS_IMLKHTMS_X "IMLKHTMS X Axis (-)" 0x016127 NO_INPUT_QUANTITY RL_AXIS_UBYTE 0 CM_IDENT_UNIT_0 8 0.0 255.0 DEPOSIT ABSOLUT /end AXIS_PTS
/begin AXIS_PTS AXIS_NWENGFS_X "NWENGFS X Axis (-)" 0x01613F NO_INPUT_QUANTITY RL_AXIS_UBYTE 0 CM_IDENT_UNIT_0 5 0.0 255.0 DEPOSIT ABSOLUT /end AXIS_PTS
/begin AXIS_PTS AXIS_KFNLLKHM_X "KFNLLKHM X Axis (tmot (coolant deg C))" 0x0162DB NO_INPUT_QUANTITY RL_AXIS_UBYTE 0 CM_LIN_tmot_coolant_deg_1 8 -48.0 143.25 DEPOSIT ABSOLUT /end AXIS_PTS
/begin AXIS_PTS AXIS_KFNLLKHM_Y "KFNLLKHM Y Axis (frhokor (cat heating step))" 0x0162E4 NO_INPUT_QUANTITY RL_AXIS_UBYTE 0 CM_IDENT_frhokor_cat_heat_5 4 0.0 255.0 DEPOSIT ABSOLUT /end AXIS_PTS
/begin AXIS_PTS AXIS_KIRMSMS_X "KIRMSMS X Axis (-)" 0x01678B NO_INPUT_QUANTITY RL_AXIS_UBYTE 0 CM_IDENT_UNIT_0 4 0.0 255.0 DEPOSIT ABSOLUT /end AXIS_PTS
/begin AXIS_PTS AXIS_FLRFKATE_X "FLRFKATE X Axis (-)" 0x01679F NO_INPUT_QUANTITY RL_AXIS_UBYTE 0 CM_IDENT_UNIT_0 5 0.0 255.0 DEPOSIT ABSOLUT /end AXIS_PTS
/begin AXIS_PTS AXIS_TLRTMS_X "TLRTMS X Axis (-)" 0x0167B7 NO_INPUT_QUANTITY RL_AXIS_UBYTE 0 CM_IDENT_UNIT_0 5 0.0 255.0 DEPOSIT ABSOLUT /end AXIS_PTS
/begin AXIS_PTS AXIS_TLRZWTMS_X "TLRZWTMS X Axis (-)" 0x0167C7 NO_INPUT_QUANTITY RL_AXIS_UBYTE 0 CM_IDENT_UNIT_0 4 0.0 255.0 DEPOSIT ABSOLUT /end AXIS_PTS
/begin AXIS_PTS AXIS_TVNWSTTM_X "TVNWSTTM X Axis (-)" 0x0167D5 NO_INPUT_QUANTITY RL_AXIS_UBYTE 0 CM_IDENT_UNIT_0 4 0.0 255.0 DEPOSIT ABSOLUT /end AXIS_PTS
/begin AXIS_PTS AXIS_LALIUSRH_X "LALIUSRH X Axis (-)" 0x016837 NO_INPUT_QUANTITY RL_AXIS_UBYTE 0 CM_IDENT_UNIT_0 10 0.0 255.0 DEPOSIT ABSOLUT /end AXIS_PTS
/begin AXIS_PTS AXIS_LALIUSRH2_X "LALIUSRH2 X Axis (-)" 0x016857 NO_INPUT_QUANTITY RL_AXIS_UBYTE 0 CM_IDENT_UNIT_0 10 0.0 255.0 DEPOSIT ABSOLUT /end AXIS_PTS
/begin AXIS_PTS AXIS_TSBBVTMS_X "TSBBVTMS X Axis (-)" 0x0168F9 NO_INPUT_QUANTITY RL_AXIS_UBYTE 0 CM_IDENT_UNIT_0 4 0.0 255.0 DEPOSIT ABSOLUT /end AXIS_PTS
/begin AXIS_PTS AXIS_KFZWWLNM_X "KFZWWLNM X Axis (-)" 0x0168FF NO_INPUT_QUANTITY RL_AXIS_UBYTE 0 CM_IDENT_UNIT_0 16 0.0 255.0 DEPOSIT ABSOLUT /end AXIS_PTS
/begin AXIS_PTS AXIS_KFZWWLNM_Y "KFZWWLNM Y Axis (-)" 0x016910 NO_INPUT_QUANTITY RL_AXIS_UBYTE 0 CM_IDENT_UNIT_0 6 0.0 255.0 DEPOSIT ABSOLUT /end AXIS_PTS
/begin AXIS_PTS AXIS_TAPVLTM_X "TAPVLTM X Axis (-)" 0x016977 NO_INPUT_QUANTITY RL_AXIS_UBYTE 0 CM_IDENT_UNIT_0 12 0.0 255.0 DEPOSIT ABSOLUT /end AXIS_PTS
/begin AXIS_PTS AXIS_WPHN_X "WPHN X Axis (-)" 0x017B88 NO_INPUT_QUANTITY RL_AXIS_UBYTE 0 CM_IDENT_UNIT_0 8 0.0 255.0 DEPOSIT ABSOLUT /end AXIS_PTS
/begin AXIS_PTS AXIS_KFVSKG_X "KFVSKG X Axis (-)" 0x017CF6 NO_INPUT_QUANTITY RL_AXIS_UBYTE 0 CM_IDENT_UNIT_0 8 0.0 255.0 DEPOSIT ABSOLUT /end AXIS_PTS
/begin AXIS_PTS AXIS_REDZEM_X "REDZEM X Axis (-)" 0x019001 NO_INPUT_QUANTITY RL_AXIS_UBYTE 0 CM_IDENT_UNIT_0 5 0.0 255.0 DEPOSIT ABSOLUT /end AXIS_PTS
/begin AXIS_PTS AXIS_CWVSV_X "CWVSV X Axis (-)" 0x019069 NO_INPUT_QUANTITY RL_AXIS_UBYTE 0 CM_IDENT_UNIT_0 8 0.0 255.0 DEPOSIT ABSOLUT /end AXIS_PTS
/begin AXIS_PTS AXIS_KFTEVP_X "KFTEVP X Axis (nmot (RPM))" 0x0190B4 NO_INPUT_QUANTITY RL_AXIS_UBYTE 0 CM_LIN_nmot_RPM_3 5 0.0 10200.0 DEPOSIT ABSOLUT /end AXIS_PTS
/begin AXIS_PTS AXIS_KFTEVP_Y "KFTEVP Y Axis (tateroh (% purge flow))" 0x0190BA NO_INPUT_QUANTITY RL_AXIS_UBYTE 0 CM_LIN_tateroh_purge_fl_6 9 0.0 100.0 DEPOSIT ABSOLUT /end AXIS_PTS
/begin AXIS_PTS AXIS_FBTEVA_X "FBTEVA X Axis (-)" 0x01910C NO_INPUT_QUANTITY RL_AXIS_UBYTE 0 CM_IDENT_UNIT_0 6 0.0 255.0 DEPOSIT ABSOLUT /end AXIS_PTS
/begin AXIS_PTS AXIS_KLDYNCOR_X "KLDYNCOR X Axis (-)" 0x0191A7 NO_INPUT_QUANTITY RL_AXIS_UBYTE 0 CM_IDENT_UNIT_0 4 0.0 255.0 DEPOSIT ABSOLUT /end AXIS_PTS
/begin AXIS_PTS AXIS_KFTATX_X "KFTATX X Axis (-)" 0x0191E8 NO_INPUT_QUANTITY RL_AXIS_UBYTE 0 CM_IDENT_UNIT_0 10 0.0 255.0 DEPOSIT ABSOLUT /end AXIS_PTS
/begin AXIS_PTS AXIS_KFTATX_Y "KFTATX Y Axis (-)" 0x0191F3 NO_INPUT_QUANTITY RL_AXIS_UBYTE 0 CM_IDENT_UNIT_0 6 0.0 255.0 DEPOSIT ABSOLUT /end AXIS_PTS
/begin AXIS_PTS AXIS_ZVNWVSR_X "ZVNWVSR X Axis (-)" 0x0192D2 NO_INPUT_QUANTITY RL_AXIS_UBYTE 0 CM_IDENT_UNIT_0 8 0.0 255.0 DEPOSIT ABSOLUT /end AXIS_PTS
/begin AXIS_PTS AXIS_FMSTMOT_X "FMSTMOT X Axis (-)" 0x019354 NO_INPUT_QUANTITY RL_AXIS_UBYTE 0 CM_IDENT_UNIT_0 8 0.0 255.0 DEPOSIT ABSOLUT /end AXIS_PTS
/begin AXIS_PTS AXIS_KFTATM_X "KFTATM X Axis (nmot_ub_q40)" 0x019458 NO_INPUT_QUANTITY RL_AXIS_UBYTE 0 CM_LIN_nmot_ub_q40_7 8 0.0 10200.0 DEPOSIT ABSOLUT /end AXIS_PTS
/begin AXIS_PTS AXIS_KFTATM_Y "KFTATM Y Axis (rel_ub_q0p75)" 0x019460 NO_INPUT_QUANTITY RL_AXIS_UBYTE 0 CM_LIN_rel_ub_q0p75_8 8 0.0 191.25 DEPOSIT ABSOLUT /end AXIS_PTS
/begin AXIS_PTS AXIS_KFTATM2_X "KFTATM2 X Axis (nmot_ub_q40)" 0x0194AA NO_INPUT_QUANTITY RL_AXIS_UBYTE 0 CM_LIN_nmot_ub_q40_7 8 0.0 10200.0 DEPOSIT ABSOLUT /end AXIS_PTS
/begin AXIS_PTS AXIS_KFTATM2_Y "KFTATM2 Y Axis (rel_ub_q0p75)" 0x0194B2 NO_INPUT_QUANTITY RL_AXIS_UBYTE 0 CM_LIN_rel_ub_q0p75_8 8 0.0 191.25 DEPOSIT ABSOLUT /end AXIS_PTS
/begin AXIS_PTS AXIS_TFKWAVTMS_X "TFKWAVTMS X Axis (-)" 0x019504 NO_INPUT_QUANTITY RL_AXIS_UBYTE 0 CM_IDENT_UNIT_0 4 0.0 255.0 DEPOSIT ABSOLUT /end AXIS_PTS
/begin AXIS_PTS AXIS_KFRINH_X "KFRINH X Axis (tkatmf (temp deg C))" 0x019566 NO_INPUT_QUANTITY RL_AXIS_UBYTE 0 CM_LIN_tkatmf_temp_deg__9 5 -50.0 1225.0 DEPOSIT ABSOLUT /end AXIS_PTS
/begin AXIS_PTS AXIS_KFRINH_Y "KFRINH Y Axis (phlsnhf (flow factor))" 0x01956C NO_INPUT_QUANTITY RL_AXIS_UBYTE 0 CM_LIN_phlsnhf_flow_fac_10 3 0.0 2.55 DEPOSIT ABSOLUT /end AXIS_PTS
/begin AXIS_PTS AXIS_KFRINH2_X "KFRINH2 X Axis (tkatmf2 (temp deg C))" 0x01957F NO_INPUT_QUANTITY RL_AXIS_UBYTE 0 CM_LIN_tkatmf2_temp_deg_11 5 -50.0 1225.0 DEPOSIT ABSOLUT /end AXIS_PTS
/begin AXIS_PTS AXIS_KFRINH2_Y "KFRINH2 Y Axis (phlsnhf2 (flow factor))" 0x019585 NO_INPUT_QUANTITY RL_AXIS_UBYTE 0 CM_LIN_phlsnhf2_flow_fa_12 3 0.0 2.55 DEPOSIT ABSOLUT /end AXIS_PTS
/begin AXIS_PTS AXIS_KFVSGK_X "KFVSGK X Axis (-)" 0x0195C9 NO_INPUT_QUANTITY RL_AXIS_UBYTE 0 CM_IDENT_UNIT_0 8 0.0 255.0 DEPOSIT ABSOLUT /end AXIS_PTS
/begin AXIS_PTS AXIS_KFZW4_X "KFZW4 X Axis (-)" 0x019649 NO_INPUT_QUANTITY RL_AXIS_UBYTE 0 CM_IDENT_UNIT_0 4 0.0 255.0 DEPOSIT ABSOLUT /end AXIS_PTS
/begin AXIS_PTS AXIS_KFMRES_X "KFMRES X Axis (nmot (RPM))" 0x019685 NO_INPUT_QUANTITY RL_AXIS_UBYTE 0 CM_LIN_nmot_RPM_3 10 0.0 10200.0 DEPOSIT ABSOLUT /end AXIS_PTS
/begin AXIS_PTS AXIS_KFMRES_Y "KFMRES Y Axis (mifa (torque %))" 0x019690 NO_INPUT_QUANTITY RL_AXIS_UBYTE 0 CM_LIN_mifa_torque_13 8 0.0 1.9922 DEPOSIT ABSOLUT /end AXIS_PTS
/begin AXIS_PTS AXIS_KFLURBZ_X "KFLURBZ X Axis (-)" 0x019787 NO_INPUT_QUANTITY RL_AXIS_UBYTE 0 CM_IDENT_UNIT_0 6 0.0 255.0 DEPOSIT ABSOLUT /end AXIS_PTS
/begin AXIS_PTS AXIS_TNWSUK1_X "TNWSUK1 X Axis (-)" 0x0197F4 NO_INPUT_QUANTITY RL_AXIS_UBYTE 0 CM_IDENT_UNIT_0 6 0.0 255.0 DEPOSIT ABSOLUT /end AXIS_PTS
/begin AXIS_PTS AXIS_TVVSES_X "TVVSES X Axis (-)" 0x0198DD NO_INPUT_QUANTITY RL_AXIS_UBYTE 0 CM_IDENT_UNIT_0 8 0.0 255.0 DEPOSIT ABSOLUT /end AXIS_PTS
/begin AXIS_PTS AXIS_FKKVS_X "FKKVS X Axis (nmot (RPM))" 0x0198F0 NO_INPUT_QUANTITY RL_AXIS_UBYTE 0 CM_LIN_nmot_RPM_3 16 0.0 10200.0 DEPOSIT ABSOLUT /end AXIS_PTS
/begin AXIS_PTS AXIS_FKKVS_Y "FKKVS Y Axis (tevfa (inj time raw))" 0x019900 NO_INPUT_QUANTITY RL_AXIS_UBYTE 0 CM_LIN_tevfa_inj_time_r_14 16 0.0 1.9922 DEPOSIT ABSOLUT /end AXIS_PTS
/begin AXIS_PTS AXIS_FFWK_X "FFWK X Axis (-)" 0x019A17 NO_INPUT_QUANTITY RL_AXIS_UBYTE 0 CM_IDENT_UNIT_0 5 0.0 255.0 DEPOSIT ABSOLUT /end AXIS_PTS
/begin AXIS_PTS AXIS_KLDNFHO_X "KLDNFHO X Axis (-)" 0x019A5E NO_INPUT_QUANTITY RL_AXIS_UBYTE 0 CM_IDENT_UNIT_0 4 0.0 255.0 DEPOSIT ABSOLUT /end AXIS_PTS
/begin AXIS_PTS AXIS_NASNOTKL_X "NASNOTKL X Axis (-)" 0x019CA7 NO_INPUT_QUANTITY RL_AXIS_UBYTE 0 CM_IDENT_UNIT_0 4 0.0 255.0 DEPOSIT ABSOLUT /end AXIS_PTS
/begin AXIS_PTS AXIS_TNWSUK2_X "TNWSUK2 X Axis (-)" 0x019F0E NO_INPUT_QUANTITY RL_AXIS_UBYTE 0 CM_IDENT_UNIT_0 6 0.0 255.0 DEPOSIT ABSOLUT /end AXIS_PTS
/begin AXIS_PTS AXIS_LMSTMOT_X "LMSTMOT X Axis (-)" 0x019F4D NO_INPUT_QUANTITY RL_AXIS_UBYTE 0 CM_IDENT_UNIT_0 4 0.0 255.0 DEPOSIT ABSOLUT /end AXIS_PTS
/begin AXIS_PTS AXIS_DTLRTML_X "DTLRTML X Axis (-)" 0x019F85 NO_INPUT_QUANTITY RL_AXIS_UBYTE 0 CM_IDENT_UNIT_0 7 0.0 255.0 DEPOSIT ABSOLUT /end AXIS_PTS
/begin AXIS_PTS AXIS_TWLRTMS_X "TWLRTMS X Axis (-)" 0x019FD2 NO_INPUT_QUANTITY RL_AXIS_UBYTE 0 CM_IDENT_UNIT_0 4 0.0 255.0 DEPOSIT ABSOLUT /end AXIS_PTS
/begin AXIS_PTS AXIS_DNLBZFS_X "DNLBZFS X Axis (-)" 0x01A000 NO_INPUT_QUANTITY RL_AXIS_UBYTE 0 CM_IDENT_UNIT_0 6 0.0 255.0 DEPOSIT ABSOLUT /end AXIS_PTS
/begin AXIS_PTS AXIS_TVVSESL_X "TVVSESL X Axis (-)" 0x01A024 NO_INPUT_QUANTITY RL_AXIS_UBYTE 0 CM_IDENT_UNIT_0 8 0.0 255.0 DEPOSIT ABSOLUT /end AXIS_PTS
/begin AXIS_PTS AXIS_FTMLAKH_X "FTMLAKH X Axis (-)" 0x01A039 NO_INPUT_QUANTITY RL_AXIS_UBYTE 0 CM_IDENT_UNIT_0 4 0.0 255.0 DEPOSIT ABSOLUT /end AXIS_PTS
/begin AXIS_PTS AXIS_KFSZT_X "KFSZT X Axis (spg_ubatt)" 0x01A07F NO_INPUT_QUANTITY RL_AXIS_UBYTE 0 CM_LIN_spg_ubatt_15 8 0.0 19.38 DEPOSIT ABSOLUT /end AXIS_PTS
/begin AXIS_PTS AXIS_KFSZT_Y "KFSZT Y Axis (nmot_ub_q40)" 0x01A087 NO_INPUT_QUANTITY RL_AXIS_UBYTE 0 CM_LIN_nmot_ub_q40_7 8 0.0 10200.0 DEPOSIT ABSOLUT /end AXIS_PTS
/begin AXIS_PTS AXIS_MVER_T_UM_X "MVER_T_UM X Axis (-)" 0x01A0D0 NO_INPUT_QUANTITY RL_AXIS_UBYTE 0 CM_IDENT_UNIT_0 8 0.0 255.0 DEPOSIT ABSOLUT /end AXIS_PTS
/begin AXIS_PTS AXIS_FTVVSV_X "FTVVSV X Axis (-)" 0x01A122 NO_INPUT_QUANTITY RL_AXIS_UBYTE 0 CM_IDENT_UNIT_0 8 0.0 255.0 DEPOSIT ABSOLUT /end AXIS_PTS
/begin AXIS_PTS AXIS_AZKRLDYN_X "AZKRLDYN X Axis (-)" 0x01A14B NO_INPUT_QUANTITY RL_AXIS_UBYTE 0 CM_IDENT_UNIT_0 15 0.0 255.0 DEPOSIT ABSOLUT /end AXIS_PTS
/begin AXIS_PTS AXIS_ZSYNAUSW_X "ZSYNAUSW X Axis (-)" 0x01A296 NO_INPUT_QUANTITY RL_AXIS_UBYTE 0 CM_IDENT_UNIT_0 4 0.0 255.0 DEPOSIT ABSOLUT /end AXIS_PTS
/begin AXIS_PTS AXIS_TABGMEX_X "TABGMEX X Axis (-)" 0x01A347 NO_INPUT_QUANTITY RL_AXIS_UBYTE 0 CM_IDENT_UNIT_0 5 0.0 255.0 DEPOSIT ABSOLUT /end AXIS_PTS
/begin AXIS_PTS AXIS_KFMDKO_X "KFMDKO X Axis (nmot_ub_q40)" 0x01A36B NO_INPUT_QUANTITY RL_AXIS_UBYTE 0 CM_LIN_nmot_ub_q40_7 6 0.0 10200.0 DEPOSIT ABSOLUT /end AXIS_PTS
/begin AXIS_PTS AXIS_KFMDKO_Y "KFMDKO Y Axis (dez)" 0x01A372 NO_INPUT_QUANTITY RL_AXIS_UBYTE 0 CM_IDENT_dez_16 8 0.0 255.0 DEPOSIT ABSOLUT /end AXIS_PTS
/begin AXIS_PTS AXIS_KINMXRLG_X "KINMXRLG X Axis (rel_ub_q0p75)" 0x01A42D NO_INPUT_QUANTITY RL_AXIS_UBYTE 0 CM_LIN_rel_ub_q0p75_8 8 0.0 191.25 DEPOSIT ABSOLUT /end AXIS_PTS
/begin AXIS_PTS AXIS_KINMXRLG_Y "KINMXRLG Y Axis (dez)" 0x01A435 NO_INPUT_QUANTITY RL_AXIS_UBYTE 0 CM_IDENT_dez_16 8 0.0 255.0 DEPOSIT ABSOLUT /end AXIS_PTS
/begin AXIS_PTS AXIS_KFDETATE_X "KFDETATE X Axis (rel_ub_b127p5)" 0x01A4D7 NO_INPUT_QUANTITY RL_AXIS_UBYTE 0 CM_LIN_rel_ub_b127p5_17 4 0.0 127.5 DEPOSIT ABSOLUT /end AXIS_PTS
/begin AXIS_PTS AXIS_KFDETATE_Y "KFDETATE Y Axis (m_q0p1)" 0x01A4DC NO_INPUT_QUANTITY RL_AXIS_UBYTE 0 CM_LIN_m_q0p1_18 6 0.0 25.5 DEPOSIT ABSOLUT /end AXIS_PTS
/begin AXIS_PTS AXIS_KFTVFRR_X "KFTVFRR X Axis (rel_ub_b99p6)" 0x01A4FB NO_INPUT_QUANTITY RL_AXIS_UBYTE 0 CM_LIN_rel_ub_b99p6_19 4 0.0 99.6094 DEPOSIT ABSOLUT /end AXIS_PTS
/begin AXIS_PTS AXIS_KFTVFRR_Y "KFTVFRR Y Axis (m_ub_b1020)" 0x01A500 NO_INPUT_QUANTITY RL_AXIS_UBYTE 0 CM_LIN_m_ub_b1020_20 3 0.0 1020.0 DEPOSIT ABSOLUT /end AXIS_PTS
/begin AXIS_PTS AXIS_TADTEAMX_X "TADTEAMX X Axis (-)" 0x01A510 NO_INPUT_QUANTITY RL_AXIS_UBYTE 0 CM_IDENT_UNIT_0 14 0.0 255.0 DEPOSIT ABSOLUT /end AXIS_PTS
/begin AXIS_PTS AXIS_FFRITMS_X "FFRITMS X Axis (-)" 0x01A541 NO_INPUT_QUANTITY RL_AXIS_UBYTE 0 CM_IDENT_UNIT_0 4 0.0 255.0 DEPOSIT ABSOLUT /end AXIS_PTS
/begin AXIS_PTS AXIS_KFRI_X "KFRI X Axis (-)" 0x01A54A NO_INPUT_QUANTITY RL_AXIS_UBYTE 0 CM_IDENT_UNIT_0 5 0.0 255.0 DEPOSIT ABSOLUT /end AXIS_PTS
/begin AXIS_PTS AXIS_KFRI2_X "KFRI2 X Axis (-)" 0x01A574 NO_INPUT_QUANTITY RL_AXIS_UBYTE 0 CM_IDENT_UNIT_0 5 0.0 255.0 DEPOSIT ABSOLUT /end AXIS_PTS
/begin AXIS_PTS AXIS_RLLRUN_X "RLLRUN X Axis (-)" 0x01A649 NO_INPUT_QUANTITY RL_AXIS_UBYTE 0 CM_IDENT_UNIT_0 8 0.0 255.0 DEPOSIT ABSOLUT /end AXIS_PTS
/begin AXIS_PTS AXIS_ZLRHML_X "ZLRHML X Axis (-)" 0x01A723 NO_INPUT_QUANTITY RL_AXIS_UBYTE 0 CM_IDENT_UNIT_0 6 0.0 255.0 DEPOSIT ABSOLUT /end AXIS_PTS
/begin AXIS_PTS AXIS_FIMALU_X "FIMALU X Axis (-)" 0x01A738 NO_INPUT_QUANTITY RL_AXIS_UBYTE 0 CM_IDENT_UNIT_0 5 0.0 255.0 DEPOSIT ABSOLUT /end AXIS_PTS
/begin AXIS_PTS AXIS_FKAXAVKAT_X "FKAXAVKAT X Axis (-)" 0x01A77B NO_INPUT_QUANTITY RL_AXIS_UBYTE 0 CM_IDENT_UNIT_0 5 0.0 255.0 DEPOSIT ABSOLUT /end AXIS_PTS
/begin AXIS_PTS AXIS_FQTEFR_X "FQTEFR X Axis (-)" 0x01A787 NO_INPUT_QUANTITY RL_AXIS_UBYTE 0 CM_IDENT_UNIT_0 8 0.0 255.0 DEPOSIT ABSOLUT /end AXIS_PTS
/begin AXIS_PTS AXIS_KFURL_X "KFURL X Axis (wnwue_w (cam deg KW))" 0x01A9CC NO_INPUT_QUANTITY RL_AXIS_UWORD 0 CM_LIN_wnwue_w_cam_deg__21 6 0.0 124.5165 DEPOSIT ABSOLUT /end AXIS_PTS
/begin AXIS_PTS AXIS_KFURL_Y "KFURL Y Axis (nmot_w (RPM))" 0x01A9D8 NO_INPUT_QUANTITY RL_AXIS_UWORD 0 CM_LIN_nmot_w_RPM_22 10 0.0 16383.75 DEPOSIT ABSOLUT /end AXIS_PTS
/begin AXIS_PTS AXIS_DNLBZ_X "DNLBZ X Axis (-)" 0x01B3FF NO_INPUT_QUANTITY RL_AXIS_UBYTE 0 CM_IDENT_UNIT_0 6 0.0 255.0 DEPOSIT ABSOLUT /end AXIS_PTS
/begin AXIS_PTS AXIS_KFDTMTU_X "KFDTMTU X Axis (-)" 0x01B95A NO_INPUT_QUANTITY RL_AXIS_UBYTE 0 CM_IDENT_UNIT_0 5 0.0 255.0 DEPOSIT ABSOLUT /end AXIS_PTS
/begin AXIS_PTS AXIS_KFDTMTU_Y "KFDTMTU Y Axis (-)" 0x01B95F NO_INPUT_QUANTITY RL_AXIS_UBYTE 0 CM_IDENT_UNIT_0 4 0.0 255.0 DEPOSIT ABSOLUT /end AXIS_PTS
/begin AXIS_PTS AXIS_IMLLASKH_X "IMLLASKH X Axis (-)" 0x01B979 NO_INPUT_QUANTITY RL_AXIS_UBYTE 0 CM_IDENT_UNIT_0 5 0.0 255.0 DEPOSIT ABSOLUT /end AXIS_PTS
/begin AXIS_PTS AXIS_KFTSRL_X "KFTSRL X Axis (ub (battery V))" 0x01BC32 NO_INPUT_QUANTITY RL_AXIS_UWORD 0 CM_LIN_ub_battery_V_23 6 0.0 159.9976 DEPOSIT ABSOLUT /end AXIS_PTS
/begin AXIS_PTS AXIS_KFTSRL_Y "KFTSRL Y Axis (nmot_w (RPM))" 0x01BC3E NO_INPUT_QUANTITY RL_AXIS_UWORD 0 CM_LIN_nmot_w_RPM_22 6 0.0 16383.75 DEPOSIT ABSOLUT /end AXIS_PTS
/begin AXIS_PTS AXIS_KFFRMIN_X "KFFRMIN X Axis (-)" 0x01BD5D NO_INPUT_QUANTITY RL_AXIS_UBYTE 0 CM_IDENT_UNIT_0 5 0.0 255.0 DEPOSIT ABSOLUT /end AXIS_PTS
/begin AXIS_PTS AXIS_DZWAML_X "DZWAML X Axis (-)" 0x01BEB1 NO_INPUT_QUANTITY RL_AXIS_UBYTE 0 CM_IDENT_UNIT_0 12 0.0 255.0 DEPOSIT ABSOLUT /end AXIS_PTS
/begin AXIS_PTS AXIS_DLAMOB_X "DLAMOB X Axis (-)" 0x01BECD NO_INPUT_QUANTITY RL_AXIS_UBYTE 0 CM_IDENT_UNIT_0 6 0.0 255.0 DEPOSIT ABSOLUT /end AXIS_PTS
/begin AXIS_PTS AXIS_DMADFK_X "DMADFK X Axis (-)" 0x01BEDB NO_INPUT_QUANTITY RL_AXIS_UBYTE 0 CM_IDENT_UNIT_0 6 0.0 255.0 DEPOSIT ABSOLUT /end AXIS_PTS
/begin AXIS_PTS AXIS_KFZWWLTM_X "KFZWWLTM X Axis (tmot (coolant deg C))" 0x01BEEA NO_INPUT_QUANTITY RL_AXIS_UBYTE 0 CM_LIN_tmot_coolant_deg_1 12 -48.0 143.25 DEPOSIT ABSOLUT /end AXIS_PTS
/begin AXIS_PTS AXIS_KFZWWLTM_Y "KFZWWLTM Y Axis (tmst (start deg C))" 0x01BEF6 NO_INPUT_QUANTITY RL_AXIS_UBYTE 0 CM_LIN_tmst_start_deg_C_2 12 -48.0 143.25 DEPOSIT ABSOLUT /end AXIS_PTS
/begin AXIS_PTS AXIS_KFNWSE_X "KFNWSE X Axis (nmot_w (RPM))" 0x01C0E4 NO_INPUT_QUANTITY RL_AXIS_UWORD 0 CM_LIN_nmot_w_RPM_22 16 0.0 16383.75 DEPOSIT ABSOLUT /end AXIS_PTS
/begin AXIS_PTS AXIS_KFNWSE_Y "KFNWSE Y Axis (rlnw_w (load %))" 0x01C104 NO_INPUT_QUANTITY RL_AXIS_UWORD 0 CM_LIN_rlnw_w_load_24 8 0.0 1535.9766 DEPOSIT ABSOLUT /end AXIS_PTS
/begin AXIS_PTS AXIS_VSL_X "VSL X Axis (-)" 0x01CCA1 NO_INPUT_QUANTITY RL_AXIS_UBYTE 0 CM_IDENT_UNIT_0 4 0.0 255.0 DEPOSIT ABSOLUT /end AXIS_PTS
/begin AXIS_PTS AXIS_DMLLRMXN_X "DMLLRMXN X Axis (nmot)" 0x01184D NO_INPUT_QUANTITY RL_AXIS_UBYTE 0 CM_LIN_nmot_25 6 0.0 10200.0 DEPOSIT ABSOLUT /end AXIS_PTS
/begin AXIS_PTS AXIS_FRINH1_X "FRINH1 X Axis (tkatmf)" 0x01182A NO_INPUT_QUANTITY RL_AXIS_UBYTE 0 CM_LIN_tkatmf_26 5 -50.0 1225.0 DEPOSIT ABSOLUT /end AXIS_PTS
/begin CHARACTERISTIC TVSATEM "Verzögerungszeit für TEV zu nach SA-Bereitschaft" CURVE 0x010026 RL_UBYTE 0 CM_IDENT_s_27 0.0 255.0
 /begin AXIS_DESCR COM_AXIS NO_INPUT_QUANTITY CM_IDENT_UNIT_0 6 0.0 255.0 AXIS_PTS_REF AXIS_TVSATEM_X /end AXIS_DESCR
/end CHARACTERISTIC
/begin CHARACTERISTIC FFTBREMS "FFTBREMS" VALUE 0x01003D RL_SBYTE 0 CM_IDENT_UNIT_0 -128.0 127.0 /end CHARACTERISTIC
/begin CHARACTERISTIC KFWKST_1004A "1D Curve KFWKST_1004A (BGWL)" CURVE 0x01004A RL_UBYTE 0 CM_LIN_MDNORM_28 0.0 31.875 /begin AXIS_DESCR FIX_AXIS NO_INPUT_QUANTITY CM_IDENT_UNIT_0 8 0 7 /end AXIS_DESCR /end CHARACTERISTIC
/begin CHARACTERISTIC FFTDMPME "FFTDMPME" VALUE 0x010088 RL_SBYTE 0 CM_IDENT_UNIT_0 -128.0 127.0 /end CHARACTERISTIC
/begin CHARACTERISTIC KFDWTBR2 "Wichtungsfaktor Brennraumtemperaturmodell abhängig von NWS-Stellung" CURVE 0x0104CD RL_UBYTE 0 CM_LIN_UNIT_29 0.0 1.9922
 /begin AXIS_DESCR COM_AXIS NO_INPUT_QUANTITY CM_IDENT_UNIT_0 10 0.0 255.0 AXIS_PTS_REF AXIS_KFDWTBR2_X /end AXIS_DESCR
/end CHARACTERISTIC
/begin CHARACTERISTIC KFFWL "Engine Warmup Fuel Enrichment Multiplier" MAP 0x010556 RL_UBYTE 0 CM_LIN_warmup_factor_30 0.0 1.9922
 /begin AXIS_DESCR COM_AXIS NO_INPUT_QUANTITY CM_LIN_tmot_coolant_deg_1 12 -48.0 143.25 AXIS_PTS_REF AXIS_KFFWL_X /end AXIS_DESCR
 /begin AXIS_DESCR COM_AXIS NO_INPUT_QUANTITY CM_LIN_tmst_start_deg_C_2 12 -48.0 143.25 AXIS_PTS_REF AXIS_KFFWL_Y /end AXIS_DESCR
/end CHARACTERISTIC
/begin CHARACTERISTIC KLTNMXPR "Zeit für Drehzahlprädiktion der NMAX-Regelung" CURVE 0x010609 RL_UBYTE 0 CM_LIN_s_31 0.0 2.55
 /begin AXIS_DESCR COM_AXIS NO_INPUT_QUANTITY CM_IDENT_UNIT_0 8 0.0 255.0 AXIS_PTS_REF AXIS_KLTNMXPR_X /end AXIS_DESCR
/end CHARACTERISTIC
/begin CHARACTERISTIC DTUMTAT "Offset Ansauglufttemperatur -> Umgebungstemperatur" CURVE 0x010629 RL_UBYTE 0 CM_IDENT_Grad_C_32 0.0 255.0
 /begin AXIS_DESCR COM_AXIS NO_INPUT_QUANTITY CM_IDENT_UNIT_0 5 0.0 255.0 AXIS_PTS_REF AXIS_DTUMTAT_X /end AXIS_DESCR
/end CHARACTERISTIC
/begin CHARACTERISTIC ZKFNS "Zeitkonstante Nockenwelle kaltverstellt" CURVE 0x010638 RL_UBYTE 0 CM_IDENT_s_27 0.0 255.0
 /begin AXIS_DESCR COM_AXIS NO_INPUT_QUANTITY CM_IDENT_UNIT_0 7 0.0 255.0 AXIS_PTS_REF AXIS_ZKFNS_X /end AXIS_DESCR
/end CHARACTERISTIC
/begin CHARACTERISTIC ZVNWVS "ZVNWVS" CURVE 0x01069C RL_UBYTE 0 CM_LIN_s_33 0.0 5.1
 /begin AXIS_DESCR COM_AXIS NO_INPUT_QUANTITY CM_IDENT_UNIT_0 8 0.0 255.0 AXIS_PTS_REF AXIS_ZVNWVS_X /end AXIS_DESCR
/end CHARACTERISTIC
/begin CHARACTERISTIC DMLLRLMNN_10729 "1D Curve DMLLRLMNN_10729 (LLR)" CURVE 0x010729 RL_UBYTE 0 CM_IDENT_UNIT_34 0.0 255.0 /begin AXIS_DESCR FIX_AXIS NO_INPUT_QUANTITY CM_IDENT_UNIT_0 10 0 9 /end AXIS_DESCR /end CHARACTERISTIC
/begin CHARACTERISTIC DMLLRLMNN_10733 "1D Curve DMLLRLMNN_10733 (LLR)" CURVE 0x010733 RL_UBYTE 0 CM_IDENT_UNIT_34 0.0 255.0 /begin AXIS_DESCR FIX_AXIS NO_INPUT_QUANTITY CM_IDENT_UNIT_0 12 0 11 /end AXIS_DESCR /end CHARACTERISTIC
/begin CHARACTERISTIC KFLUAR "Rough Running Distance Reference Value Map (Misfire Detection)" MAP 0x010884 RL_UBYTE 0 CM_LIN_Umdr_sec_2_35 0.0 280.375 /begin AXIS_DESCR FIX_AXIS NO_INPUT_QUANTITY CM_IDENT_UNIT_0 8 0 7 /end AXIS_DESCR /begin AXIS_DESCR FIX_AXIS NO_INPUT_QUANTITY CM_IDENT_UNIT_0 8 0 7 /end AXIS_DESCR /end CHARACTERISTIC
/begin CHARACTERISTIC KFLURB "Rough Running Reference Base Value Map" MAP 0x0109CB RL_UBYTE 0 CM_LIN_Umdr_sec_2_35 0.0 280.375 /begin AXIS_DESCR FIX_AXIS NO_INPUT_QUANTITY CM_IDENT_UNIT_0 8 0 7 /end AXIS_DESCR /begin AXIS_DESCR FIX_AXIS NO_INPUT_QUANTITY CM_IDENT_UNIT_0 8 0 7 /end AXIS_DESCR /end CHARACTERISTIC
/begin CHARACTERISTIC KFDLUR "Rough Running Delta Reference Value Map" MAP 0x010A8B RL_UBYTE 0 CM_LIN_Umdr_sec_2_35 0.0 280.375 /begin AXIS_DESCR FIX_AXIS NO_INPUT_QUANTITY CM_IDENT_UNIT_0 8 0 7 /end AXIS_DESCR /begin AXIS_DESCR FIX_AXIS NO_INPUT_QUANTITY CM_IDENT_UNIT_0 8 0 7 /end AXIS_DESCR /end CHARACTERISTIC
/begin CHARACTERISTIC KFDLUR1 "Rough Running Delta Reference Value Map (Bank 2)" MAP 0x010ACB RL_UBYTE 0 CM_LIN_Umdr_sec_2_35 0.0 280.375 /begin AXIS_DESCR FIX_AXIS NO_INPUT_QUANTITY CM_IDENT_UNIT_0 8 0 7 /end AXIS_DESCR /begin AXIS_DESCR FIX_AXIS NO_INPUT_QUANTITY CM_IDENT_UNIT_0 8 0 7 /end AXIS_DESCR /end CHARACTERISTIC
/begin CHARACTERISTIC KRMXN "maximale Spätverstellung" CURVE 0x010E4B RL_UBYTE 0 CM_LIN_grad_KW_36 -191.25 -0.0
 /begin AXIS_DESCR COM_AXIS NO_INPUT_QUANTITY CM_IDENT_UNIT_0 14 0.0 255.0 AXIS_PTS_REF AXIS_KRMXN_X /end AXIS_DESCR
/end CHARACTERISTIC
/begin CHARACTERISTIC PUKANS "Intake Manifold Pressure Pulsation Correction Curve" CURVE 0x0112A5 RL_UBYTE 0 CM_LIN_factor_37 0.0 1.9922 /begin AXIS_DESCR FIX_AXIS NO_INPUT_QUANTITY CM_IDENT_UNIT_0 17 0 16 /end AXIS_DESCR /end CHARACTERISTIC
/begin CHARACTERISTIC FRLMNHO "Korrekturfaktor rlmin über Höhe" CURVE 0x0112C3 RL_UBYTE 0 CM_LIN_UNIT_29 0.0 1.9922
 /begin AXIS_DESCR COM_AXIS NO_INPUT_QUANTITY CM_IDENT_UNIT_0 5 0.0 255.0 AXIS_PTS_REF AXIS_FRLMNHO_X /end AXIS_DESCR
/end CHARACTERISTIC
/begin CHARACTERISTIC DLURMIN "Drehzahlabh. Laufunruhe-Referenz-Minimalwert 1" CURVE 0x0112DE RL_UBYTE 0 CM_IDENT_Umdr_sec_2_38 0.0 255.0
 /begin AXIS_DESCR COM_AXIS NO_INPUT_QUANTITY CM_IDENT_UNIT_0 4 0.0 255.0 AXIS_PTS_REF AXIS_DLURMIN_X /end AXIS_DESCR
/end CHARACTERISTIC
/begin CHARACTERISTIC FFTDMTK "FFTDMTK" VALUE 0x011321 RL_SBYTE 0 CM_IDENT_UNIT_0 -128.0 127.0 /end CHARACTERISTIC
/begin CHARACTERISTIC KFDZWKG "Knock Retard Timing Delta Correction" MAP 0x011354 RL_UBYTE 0 CM_LIN_deg_BTDC_retard_39 -96.0 95.25
 /begin AXIS_DESCR COM_AXIS NO_INPUT_QUANTITY CM_LIN_nmot_RPM_3 8 0.0 10200.0 AXIS_PTS_REF AXIS_KFDZWKG_X /end AXIS_DESCR
 /begin AXIS_DESCR COM_AXIS NO_INPUT_QUANTITY CM_LIN_lambas_AFR_4 5 0.0 1.9922 AXIS_PTS_REF AXIS_KFDZWKG_Y /end AXIS_DESCR
/end CHARACTERISTIC
/begin CHARACTERISTIC TVKTDTK "Temperaturabhängige Verzögerungszeit für Katdiagnose" CURVE 0x0113CF RL_UBYTE 0 CM_IDENT_s_27 0.0 255.0
 /begin AXIS_DESCR COM_AXIS NO_INPUT_QUANTITY CM_IDENT_UNIT_0 4 0.0 255.0 AXIS_PTS_REF AXIS_TVKTDTK_X /end AXIS_DESCR
/end CHARACTERISTIC
/begin CHARACTERISTIC FFTMDB "FFTMDB" VALUE 0x01140E RL_SBYTE 0 CM_IDENT_UNIT_0 -128.0 127.0 /end CHARACTERISTIC
/begin CHARACTERISTIC KFNWADGE "Festlegung des Adaptionsbereichs für Erste Flankenadaption Phasensensor Einlass" CURVE 0x01141E RL_UBYTE 0 CM_IDENT_UNIT_0 0.0 255.0
 /begin AXIS_DESCR COM_AXIS NO_INPUT_QUANTITY CM_IDENT_UNIT_0 4 0.0 255.0 AXIS_PTS_REF AXIS_KFNWADGE_X /end AXIS_DESCR
/end CHARACTERISTIC
/begin CHARACTERISTIC TANDT "Schwelle Temperaturdifferenz Ansaugluft für Heißstart" CURVE 0x011497 RL_UBYTE 0 CM_IDENT_Grad_C_32 0.0 255.0
 /begin AXIS_DESCR COM_AXIS NO_INPUT_QUANTITY CM_IDENT_UNIT_0 8 0.0 255.0 AXIS_PTS_REF AXIS_TANDT_X /end AXIS_DESCR
/end CHARACTERISTIC
/begin CHARACTERISTIC MDLF2 "stationäres Moment für laufenden Lüfter 2" CURVE 0x011563 RL_UBYTE 0 CM_LIN_UNIT_40 0.0 99.6094
 /begin AXIS_DESCR COM_AXIS NO_INPUT_QUANTITY CM_IDENT_UNIT_0 4 0.0 255.0 AXIS_PTS_REF AXIS_MDLF2_X /end AXIS_DESCR
/end CHARACTERISTIC
/begin CHARACTERISTIC KFNSTAMX "Drehzahlschwelle für STADAP aktiv" MAP 0x011567 RL_UBYTE 0 CM_IDENT_Upm_41 0.0 255.0
 /begin AXIS_DESCR COM_AXIS NO_INPUT_QUANTITY CM_IDENT_UNIT_0 4 0.0 255.0 AXIS_PTS_REF AXIS_KFNSTAMX_X /end AXIS_DESCR
 /begin AXIS_DESCR COM_AXIS NO_INPUT_QUANTITY CM_IDENT_UNIT_0 4 0.0 255.0 AXIS_PTS_REF AXIS_KFNSTAMX_Y /end AXIS_DESCR
/end CHARACTERISTIC
/begin CHARACTERISTIC DMLLRLMNN_1172F "1D Curve DMLLRLMNN_1172F (LLR)" CURVE 0x01172F RL_UBYTE 0 CM_IDENT_RPM_correction_l_42 0.0 255.0 /begin AXIS_DESCR FIX_AXIS NO_INPUT_QUANTITY CM_IDENT_UNIT_0 6 0 5 /end AXIS_DESCR /end CHARACTERISTIC
/begin CHARACTERISTIC IVDN_1173B "1D Curve IVDN_1173B (ARA)" CURVE 0x01173B RL_UBYTE 0 CM_IDENT_ms_43 0.0 255.0 /begin AXIS_DESCR FIX_AXIS NO_INPUT_QUANTITY CM_IDENT_UNIT_0 6 0 5 /end AXIS_DESCR /end CHARACTERISTIC
/begin CHARACTERISTIC DMLLRLMNN_11747 "1D Curve DMLLRLMNN_11747 (LLR)" CURVE 0x011747 RL_UBYTE 0 CM_IDENT_rpm_scaled_inter_44 0.0 255.0 /begin AXIS_DESCR FIX_AXIS NO_INPUT_QUANTITY CM_IDENT_UNIT_0 6 0 5 /end AXIS_DESCR /end CHARACTERISTIC
/begin CHARACTERISTIC DMLLRMNN_11753 "1D Curve DMLLRMNN_11753 (LLR)" CURVE 0x011753 RL_UBYTE 0 CM_IDENT_UNIT_34 0.0 255.0 /begin AXIS_DESCR FIX_AXIS NO_INPUT_QUANTITY CM_IDENT_UNIT_0 6 0 5 /end AXIS_DESCR /end CHARACTERISTIC
/begin CHARACTERISTIC KLDMDLF1_1175B "1D Curve KLDMDLF1_1175B (LLR)" CURVE 0x01175B RL_UBYTE 0 CM_IDENT_UNIT_34 0.0 255.0 /begin AXIS_DESCR FIX_AXIS NO_INPUT_QUANTITY CM_IDENT_UNIT_0 6 0 5 /end AXIS_DESCR /end CHARACTERISTIC
/begin CHARACTERISTIC ETADZW_11761 "1D Curve ETADZW_11761 (LLR)" CURVE 0x011761 RL_UBYTE 0 CM_IDENT_10ms_centisecond_45 0.0 255.0 /begin AXIS_DESCR FIX_AXIS NO_INPUT_QUANTITY CM_IDENT_UNIT_0 6 0 5 /end AXIS_DESCR /end CHARACTERISTIC
/begin CHARACTERISTIC DMLLRMNN_11767 "1D Curve DMLLRMNN_11767 (LLR)" CURVE 0x011767 RL_UBYTE 0 CM_IDENT_Nm_signed_torque_46 0.0 255.0 /begin AXIS_DESCR FIX_AXIS NO_INPUT_QUANTITY CM_IDENT_UNIT_0 6 0 5 /end AXIS_DESCR /end CHARACTERISTIC
/begin CHARACTERISTIC KLDMDLF1_1176E "1D Curve KLDMDLF1_1176E (LLR)" CURVE 0x01176E RL_UBYTE 0 CM_IDENT_0_1_correction_f_47 0.0 255.0 /begin AXIS_DESCR FIX_AXIS NO_INPUT_QUANTITY CM_IDENT_UNIT_0 6 0 5 /end AXIS_DESCR /end CHARACTERISTIC
/begin CHARACTERISTIC DMLLRMNN_11774 "1D Curve DMLLRMNN_11774 (LLR)" CURVE 0x011774 RL_UBYTE 0 CM_IDENT_ms_43 0.0 255.0 /begin AXIS_DESCR FIX_AXIS NO_INPUT_QUANTITY CM_IDENT_UNIT_0 6 0 5 /end AXIS_DESCR /end CHARACTERISTIC
/begin CHARACTERISTIC DMLLRMNN_1177A "1D Curve DMLLRMNN_1177A (LLR)" CURVE 0x01177A RL_UBYTE 0 CM_IDENT_0_1_48 0.0 255.0 /begin AXIS_DESCR FIX_AXIS NO_INPUT_QUANTITY CM_IDENT_UNIT_0 6 0 5 /end AXIS_DESCR /end CHARACTERISTIC
/begin CHARACTERISTIC DMLLRMNN_11780 "1D Curve DMLLRMNN_11780 (LLR)" CURVE 0x011780 RL_UBYTE 0 CM_IDENT_rpm_49 0.0 255.0 /begin AXIS_DESCR FIX_AXIS NO_INPUT_QUANTITY CM_IDENT_UNIT_0 6 0 5 /end AXIS_DESCR /end CHARACTERISTIC
/begin CHARACTERISTIC DMLLRLMNN_1178D "1D Curve DMLLRLMNN_1178D (LLR)" CURVE 0x01178D RL_UBYTE 0 CM_IDENT_RPM_s_rate_limit_50 0.0 255.0 /begin AXIS_DESCR FIX_AXIS NO_INPUT_QUANTITY CM_IDENT_UNIT_0 6 0 5 /end AXIS_DESCR /end CHARACTERISTIC
/begin CHARACTERISTIC DMLLRMNN_11793 "1D Curve DMLLRMNN_11793 (LLR)" CURVE 0x011793 RL_UBYTE 0 CM_IDENT_UNIT_34 0.0 255.0 /begin AXIS_DESCR FIX_AXIS NO_INPUT_QUANTITY CM_IDENT_UNIT_0 6 0 5 /end AXIS_DESCR /end CHARACTERISTIC
/begin CHARACTERISTIC KLDMDLF1_11799 "1D Curve KLDMDLF1_11799 (ARA)" CURVE 0x011799 RL_UBYTE 0 CM_IDENT_rpm_s_jerk_limit_51 0.0 255.0 /begin AXIS_DESCR FIX_AXIS NO_INPUT_QUANTITY CM_IDENT_UNIT_0 6 0 5 /end AXIS_DESCR /end CHARACTERISTIC
/begin CHARACTERISTIC DMLLRMNN_1179F "1D Curve DMLLRMNN_1179F (LLR)" CURVE 0x01179F RL_UBYTE 0 CM_IDENT_rpm_10_52 0.0 255.0 /begin AXIS_DESCR FIX_AXIS NO_INPUT_QUANTITY CM_IDENT_UNIT_0 6 0 5 /end AXIS_DESCR /end CHARACTERISTIC
/begin CHARACTERISTIC DNARAU "Drehzahlhysterese AR-Abschaltung" CURVE 0x0117E7 RL_UBYTE 0 CM_IDENT_Upm_41 0.0 255.0
 /begin AXIS_DESCR COM_AXIS NO_INPUT_QUANTITY CM_IDENT_UNIT_0 4 0.0 255.0 AXIS_PTS_REF AXIS_DNARAU_X /end AXIS_DESCR
/end CHARACTERISTIC
/begin CHARACTERISTIC KFMI_UM "Kennfeld optimales Motormoment in der Funktionsüberwachung" CURVE 0x011B46 RL_UBYTE 0 CM_LIN_UNIT_40 0.0 99.6094
 /begin AXIS_DESCR COM_AXIS NO_INPUT_QUANTITY CM_IDENT_UNIT_0 8 0.0 255.0 AXIS_PTS_REF AXIS_KFMI_UM_X /end AXIS_DESCR
/end CHARACTERISTIC
/begin CHARACTERISTIC SALUNKH "dmrkh-abh. Nullastfaktoren bei Katheizen" CURVE 0x011B4F RL_UBYTE 0 CM_LIN_UNIT_29 0.0 1.9922
 /begin AXIS_DESCR COM_AXIS NO_INPUT_QUANTITY CM_IDENT_UNIT_0 8 0.0 255.0 AXIS_PTS_REF AXIS_SALUNKH_X /end AXIS_DESCR
/end CHARACTERISTIC
/begin CHARACTERISTIC KFMI_UC "Optimal Engine Torque Map in Command Test" MAP 0x011B61 RL_UBYTE 0 CM_LIN_UNIT_40 0.0 99.6094 /begin AXIS_DESCR FIX_AXIS NO_INPUT_QUANTITY CM_IDENT_UNIT_0 8 0 7 /end AXIS_DESCR /begin AXIS_DESCR FIX_AXIS NO_INPUT_QUANTITY CM_IDENT_UNIT_0 8 0 7 /end AXIS_DESCR /end CHARACTERISTIC
/begin CHARACTERISTIC KFZW_UC "Optimal Ignition Angle Map in Command Test" MAP 0x011BA1 RL_SBYTE 0 CM_LIN_deg_CRK_53 -192.0 -0.75 /begin AXIS_DESCR FIX_AXIS NO_INPUT_QUANTITY CM_IDENT_UNIT_0 8 0 7 /end AXIS_DESCR /begin AXIS_DESCR FIX_AXIS NO_INPUT_QUANTITY CM_IDENT_UNIT_0 8 0 7 /end AXIS_DESCR /end CHARACTERISTIC
/begin CHARACTERISTIC KLETAZW_UC "Ignition Angle Efficiency vs Delta Timing in Command Test" CURVE 0x011BE1 RL_UBYTE 0 CM_LIN_UNIT_54 0.0 0.9961 /begin AXIS_DESCR FIX_AXIS NO_INPUT_QUANTITY CM_IDENT_UNIT_0 8 0 7 /end AXIS_DESCR /end CHARACTERISTIC
/begin CHARACTERISTIC KFMDZOF_UC "Offset Tolerance Map vs Allowed Torque in Command Test" MAP 0x011BF2 RL_UBYTE 0 CM_LIN_UNIT_40 0.0 99.6094 /begin AXIS_DESCR FIX_AXIS NO_INPUT_QUANTITY CM_IDENT_UNIT_0 8 0 7 /end AXIS_DESCR /begin AXIS_DESCR FIX_AXIS NO_INPUT_QUANTITY CM_IDENT_UNIT_0 8 0 7 /end AXIS_DESCR /end CHARACTERISTIC
/begin CHARACTERISTIC KFMPED_UC "Driver Requested Pedal Torque Map in Command Test" MAP 0x011C32 RL_UBYTE 0 CM_LIN_UNIT_40 0.0 99.6094 /begin AXIS_DESCR FIX_AXIS NO_INPUT_QUANTITY CM_IDENT_UNIT_0 8 0 7 /end AXIS_DESCR /begin AXIS_DESCR FIX_AXIS NO_INPUT_QUANTITY CM_IDENT_UNIT_0 8 0 7 /end AXIS_DESCR /end CHARACTERISTIC
/begin CHARACTERISTIC KFMPNS_UC "Cold Engine Pedal Torque Map in Command Test" MAP 0x011C72 RL_UBYTE 0 CM_LIN_UNIT_40 0.0 99.6094 /begin AXIS_DESCR FIX_AXIS NO_INPUT_QUANTITY CM_IDENT_UNIT_0 8 0 7 /end AXIS_DESCR /begin AXIS_DESCR FIX_AXIS NO_INPUT_QUANTITY CM_IDENT_UNIT_0 8 0 7 /end AXIS_DESCR /end CHARACTERISTIC
/begin CHARACTERISTIC KFVAKLK "Faktor für VA bei kleinem Ventilhub in ukukg" CURVE 0x011CBB RL_UBYTE 0 CM_LIN_UNIT_54 0.0 0.9961
 /begin AXIS_DESCR COM_AXIS NO_INPUT_QUANTITY CM_IDENT_UNIT_0 8 0.0 255.0 AXIS_PTS_REF AXIS_KFVAKLK_X /end AXIS_DESCR
/end CHARACTERISTIC
/begin CHARACTERISTIC KLNPED_UC "pedalsollwertabh. Drehzahlbegr. in der DK-Antrieb-Ersatzfunktion; Befehlstest" CURVE 0x011CC7 RL_UBYTE 0 CM_IDENT_Upm_41 0.0 255.0
 /begin AXIS_DESCR COM_AXIS NO_INPUT_QUANTITY CM_IDENT_UNIT_0 8 0.0 255.0 AXIS_PTS_REF AXIS_KLNPED_UC_X /end AXIS_DESCR
/end CHARACTERISTIC
/begin CHARACTERISTIC NSTMXM "Drehzahlschwelle für Startende autom. Start f(TMOT)" CURVE 0x011CDB RL_UBYTE 0 CM_IDENT_U_min_55 0.0 255.0
 /begin AXIS_DESCR COM_AXIS NO_INPUT_QUANTITY CM_IDENT_UNIT_0 4 0.0 255.0 AXIS_PTS_REF AXIS_NSTMXM_X /end AXIS_DESCR
/end CHARACTERISTIC
/begin CHARACTERISTIC KFZNSM "KFZNSM" MAP 0x011D27 RL_SBYTE 0 CM_IDENT_UNIT_0 -128.0 127.0 /begin AXIS_DESCR FIX_AXIS NO_INPUT_QUANTITY CM_IDENT_UNIT_0 1 0 0 /end AXIS_DESCR /begin AXIS_DESCR FIX_AXIS NO_INPUT_QUANTITY CM_IDENT_UNIT_0 1 0 0 /end AXIS_DESCR /end CHARACTERISTIC
/begin CHARACTERISTIC PLRHAV "Wichtungsfaktor des P-Anteils in der LRHK über KAT-Alterung" CURVE 0x011D41 RL_UBYTE 0 CM_LIN_UNIT_54 0.0 0.9961
 /begin AXIS_DESCR COM_AXIS NO_INPUT_QUANTITY CM_IDENT_UNIT_0 8 0.0 255.0 AXIS_PTS_REF AXIS_PLRHAV_X /end AXIS_DESCR
/end CHARACTERISTIC
/begin CHARACTERISTIC CRTVMAX "Größtes Tastverhältnis für EKP-Abschaltung" CURVE 0x0122B2 RL_UBYTE 0 CM_LIN_s_31 0.0 2.55
 /begin AXIS_DESCR COM_AXIS NO_INPUT_QUANTITY CM_IDENT_UNIT_0 4 0.0 255.0 AXIS_PTS_REF AXIS_CRTVMAX_X /end AXIS_DESCR
/end CHARACTERISTIC
/begin CHARACTERISTIC KLFNWSN_122CE "1D Curve KLFNWSN_122CE (NWS)" CURVE 0x0122CE RL_UBYTE 0 CM_IDENT_factor_1_256_sca_56 0.0 255.0 /begin AXIS_DESCR FIX_AXIS NO_INPUT_QUANTITY CM_IDENT_UNIT_0 6 0 5 /end AXIS_DESCR /end CHARACTERISTIC
/begin CHARACTERISTIC KLFNWSN_122D6 "1D Curve KLFNWSN_122D6 (NWS)" CURVE 0x0122D6 RL_UBYTE 0 CM_IDENT_camshaft_angle_o_57 0.0 255.0 /begin AXIS_DESCR FIX_AXIS NO_INPUT_QUANTITY CM_IDENT_UNIT_0 6 0 5 /end AXIS_DESCR /end CHARACTERISTIC
/begin CHARACTERISTIC LIMNDTES "Untere Integratorbegrenzung bei DTES" CURVE 0x012DB5 RL_UBYTE 0 CM_LIN_UNIT_58 -24.9 -0.0
 /begin AXIS_DESCR COM_AXIS NO_INPUT_QUANTITY CM_IDENT_UNIT_0 4 0.0 255.0 AXIS_PTS_REF AXIS_LIMNDTES_X /end AXIS_DESCR
/end CHARACTERISTIC
/begin CHARACTERISTIC FSZTM "Faktor Schließzeitkorrektur tmot-abhängig" CURVE 0x0142F5 RL_UBYTE 0 CM_LIN_UNIT_29 0.0 1.9922
 /begin AXIS_DESCR COM_AXIS NO_INPUT_QUANTITY CM_IDENT_UNIT_0 8 0.0 255.0 AXIS_PTS_REF AXIS_FSZTM_X /end AXIS_DESCR
/end CHARACTERISTIC
/begin CHARACTERISTIC DZWOAGR "AGR-ratenabhängiger  Offset des optimalen ZW" CURVE 0x014349 RL_UBYTE 0 CM_IDENT_grad_KW_59 0.0 255.0
 /begin AXIS_DESCR COM_AXIS NO_INPUT_QUANTITY CM_IDENT_UNIT_0 10 0.0 255.0 AXIS_PTS_REF AXIS_DZWOAGR_X /end AXIS_DESCR
/end CHARACTERISTIC
/begin CHARACTERISTIC MDSNWUE "Offset Schleppmoment für NW-Verstellung" CURVE 0x01435F RL_UBYTE 0 CM_IDENT_UNIT_34 0.0 255.0
 /begin AXIS_DESCR COM_AXIS NO_INPUT_QUANTITY CM_IDENT_UNIT_0 10 0.0 255.0 AXIS_PTS_REF AXIS_MDSNWUE_X /end AXIS_DESCR
/end CHARACTERISTIC
/begin CHARACTERISTIC KFRAT "Füllungabhängige Integrationsteigung für FRAT" CURVE 0x015E4C RL_UBYTE 0 CM_LIN_UNIT_60 0.0 0.0195
 /begin AXIS_DESCR COM_AXIS NO_INPUT_QUANTITY CM_IDENT_UNIT_0 5 0.0 255.0 AXIS_PTS_REF AXIS_KFRAT_X /end AXIS_DESCR
/end CHARACTERISTIC
/begin CHARACTERISTIC KFESFSAM "Anfangswert Einspritzkennfeld für Abmagerung bei  Fahrstufe" CURVE 0x01603D RL_UBYTE 0 CM_LIN_UNIT_61 0.0 3.9844
 /begin AXIS_DESCR COM_AXIS NO_INPUT_QUANTITY CM_IDENT_UNIT_0 5 0.0 255.0 AXIS_PTS_REF AXIS_KFESFSAM_X /end AXIS_DESCR
/end CHARACTERISTIC
/begin CHARACTERISTIC KFFFANZ "Anzahl Folgefunken" MAP 0x016046 RL_UBYTE 0 CM_IDENT_UNIT_0 0.0 255.0
 /begin AXIS_DESCR COM_AXIS NO_INPUT_QUANTITY CM_IDENT_UNIT_0 8 0.0 255.0 AXIS_PTS_REF AXIS_KFFFANZ_X /end AXIS_DESCR
 /begin AXIS_DESCR COM_AXIS NO_INPUT_QUANTITY CM_IDENT_UNIT_0 8 0.0 255.0 AXIS_PTS_REF AXIS_KFFFANZ_Y /end AXIS_DESCR
/end CHARACTERISTIC
/begin CHARACTERISTIC IMLKHTMS "imlpr-Schwelle für Übergang auf Lambda-Katheizen" CURVE 0x01612F RL_UBYTE 0 CM_LIN_UNIT_54 0.0 0.9961
 /begin AXIS_DESCR COM_AXIS NO_INPUT_QUANTITY CM_IDENT_UNIT_0 8 0.0 255.0 AXIS_PTS_REF AXIS_IMLKHTMS_X /end AXIS_DESCR
/end CHARACTERISTIC
/begin CHARACTERISTIC NWENGFS "Delta Wiedereinsetzdrehzahl bei Fahrstufe" CURVE 0x016144 RL_UBYTE 0 CM_IDENT_Upm_41 0.0 255.0
 /begin AXIS_DESCR COM_AXIS NO_INPUT_QUANTITY CM_IDENT_UNIT_0 5 0.0 255.0 AXIS_PTS_REF AXIS_NWENGFS_X /end AXIS_DESCR
/end CHARACTERISTIC
/begin CHARACTERISTIC KFNLLKHM "Target Fast-Idle Speed During Catalyst Heating" MAP 0x0162E8 RL_UBYTE 0 CM_LIN_RPM_idle_target_62 0.0 2550.0
 /begin AXIS_DESCR COM_AXIS NO_INPUT_QUANTITY CM_LIN_tmot_coolant_deg_1 8 -48.0 143.25 AXIS_PTS_REF AXIS_KFNLLKHM_X /end AXIS_DESCR
 /begin AXIS_DESCR COM_AXIS NO_INPUT_QUANTITY CM_IDENT_frhokor_cat_heat_5 4 0.0 255.0 AXIS_PTS_REF AXIS_KFNLLKHM_Y /end AXIS_DESCR
/end CHARACTERISTIC
/begin CHARACTERISTIC KIRMSMS "Integrationsgeschwindigkeit Abgleich Massenstrom TEV mit berechnetem Massenstrom" CURVE 0x01678F RL_UBYTE 0 CM_IDENT_s_kg_h_63 0.0 255.0
 /begin AXIS_DESCR COM_AXIS NO_INPUT_QUANTITY CM_IDENT_UNIT_0 4 0.0 255.0 AXIS_PTS_REF AXIS_KIRMSMS_X /end AXIS_DESCR
/end CHARACTERISTIC
/begin CHARACTERISTIC FLRFKATE "Gewichtung des Adaptionswertes fkatei aus %TEB zur Anpassung der Reglerparameter" CURVE 0x0167A4 RL_UBYTE 0 CM_LIN_UNIT_29 0.0 1.9922
 /begin AXIS_DESCR COM_AXIS NO_INPUT_QUANTITY CM_IDENT_UNIT_0 5 0.0 255.0 AXIS_PTS_REF AXIS_FLRFKATE_X /end AXIS_DESCR
/end CHARACTERISTIC
/begin CHARACTERISTIC TLRTMS "Sperrzeit LR nach Start, abhängig von der Motortemperatur bei Start" CURVE 0x0167BC RL_UBYTE 0 CM_IDENT_s_27 0.0 255.0
 /begin AXIS_DESCR COM_AXIS NO_INPUT_QUANTITY CM_IDENT_UNIT_0 5 0.0 255.0 AXIS_PTS_REF AXIS_TLRTMS_X /end AXIS_DESCR
/end CHARACTERISTIC
/begin CHARACTERISTIC TLRZWTMS "Zeit für Zwangseinschaltung LR (CARB-Forderung) nach Start" CURVE 0x0167CB RL_UBYTE 0 CM_IDENT_s_27 0.0 255.0
 /begin AXIS_DESCR COM_AXIS NO_INPUT_QUANTITY CM_IDENT_UNIT_0 4 0.0 255.0 AXIS_PTS_REF AXIS_TLRZWTMS_X /end AXIS_DESCR
/end CHARACTERISTIC
/begin CHARACTERISTIC TVNWSTTM "Zeitverzögerung im Start ab der die Nockenwelle angesteuert werden kann" CURVE 0x0167D9 RL_UBYTE 0 CM_IDENT_s_27 0.0 255.0
 /begin AXIS_DESCR COM_AXIS NO_INPUT_QUANTITY CM_IDENT_UNIT_0 4 0.0 255.0 AXIS_PTS_REF AXIS_TVNWSTTM_X /end AXIS_DESCR
/end CHARACTERISTIC
/begin CHARACTERISTIC LALIUSRH "Lambdalinearisierung, Sonde hinter Katalysator, Sollwert" CURVE 0x016841 RL_UBYTE 0 CM_LIN_UNIT_64 0.0 0.0623
 /begin AXIS_DESCR COM_AXIS NO_INPUT_QUANTITY CM_IDENT_UNIT_0 10 0.0 255.0 AXIS_PTS_REF AXIS_LALIUSRH_X /end AXIS_DESCR
/end CHARACTERISTIC
/begin CHARACTERISTIC LALIUSRH2 "Lambdalinearisierung, Sonde hinter Katalysator, Sollwert Bank2" CURVE 0x016861 RL_UBYTE 0 CM_LIN_UNIT_64 0.0 0.0623
 /begin AXIS_DESCR COM_AXIS NO_INPUT_QUANTITY CM_IDENT_UNIT_0 10 0.0 255.0 AXIS_PTS_REF AXIS_LALIUSRH2_X /end AXIS_DESCR
/end CHARACTERISTIC
/begin CHARACTERISTIC TSBBVTMS "Verzögerung Einschalten LR nach Sondenbetriebsbereitschaft" CURVE 0x0168FD RL_UBYTE 0 CM_IDENT_s_27 0.0 255.0
 /begin AXIS_DESCR COM_AXIS NO_INPUT_QUANTITY CM_IDENT_UNIT_0 4 0.0 255.0 AXIS_PTS_REF AXIS_TSBBVTMS_X /end AXIS_DESCR
/end CHARACTERISTIC
/begin CHARACTERISTIC KFZWWLNM "Delta Zündwinkel im Warmlauf" MAP 0x016916 RL_UBYTE 0 CM_IDENT_grad_KW_59 0.0 255.0
 /begin AXIS_DESCR COM_AXIS NO_INPUT_QUANTITY CM_IDENT_UNIT_0 16 0.0 255.0 AXIS_PTS_REF AXIS_KFZWWLNM_X /end AXIS_DESCR
 /begin AXIS_DESCR COM_AXIS NO_INPUT_QUANTITY CM_IDENT_UNIT_0 6 0.0 255.0 AXIS_PTS_REF AXIS_KFZWWLNM_Y /end AXIS_DESCR
/end CHARACTERISTIC
/begin CHARACTERISTIC TAPVLTM "Schwelle Abstellzeit für EKP-Vorlauf" CURVE 0x016983 RL_UBYTE 0 CM_IDENT_s_27 0.0 255.0
 /begin AXIS_DESCR COM_AXIS NO_INPUT_QUANTITY CM_IDENT_UNIT_0 12 0.0 255.0 AXIS_PTS_REF AXIS_TAPVLTM_X /end AXIS_DESCR
/end CHARACTERISTIC
/begin CHARACTERISTIC WPHN "Phasengang" CURVE 0x017B90 RL_UBYTE 0 CM_IDENT_grad_KW_59 0.0 255.0
 /begin AXIS_DESCR COM_AXIS NO_INPUT_QUANTITY CM_IDENT_UNIT_0 8 0.0 255.0 AXIS_PTS_REF AXIS_WPHN_X /end AXIS_DESCR
/end CHARACTERISTIC
/begin CHARACTERISTIC KFMI_UC2 "Secondary Command Test Engine Torque Map" MAP 0x017B99 RL_UBYTE 0 CM_LIN_UNIT_40 0.0 99.6094 /begin AXIS_DESCR FIX_AXIS NO_INPUT_QUANTITY CM_IDENT_UNIT_0 8 0 7 /end AXIS_DESCR /begin AXIS_DESCR FIX_AXIS NO_INPUT_QUANTITY CM_IDENT_UNIT_0 8 0 7 /end AXIS_DESCR /end CHARACTERISTIC
/begin CHARACTERISTIC KFZW_UC2 "Secondary Command Test Ignition Angle Map" MAP 0x017BD9 RL_SBYTE 0 CM_LIN_deg_CRK_53 -192.0 -0.75 /begin AXIS_DESCR FIX_AXIS NO_INPUT_QUANTITY CM_IDENT_UNIT_0 8 0 7 /end AXIS_DESCR /begin AXIS_DESCR FIX_AXIS NO_INPUT_QUANTITY CM_IDENT_UNIT_0 8 0 7 /end AXIS_DESCR /end CHARACTERISTIC
/begin CHARACTERISTIC KFVSKG "Faktor Anreicherung bei Wechsel Webtilhub klein nach groß" CURVE 0x017CFE RL_UBYTE 0 CM_LIN_UNIT_61 0.0 3.9844
 /begin AXIS_DESCR COM_AXIS NO_INPUT_QUANTITY CM_IDENT_UNIT_0 8 0.0 255.0 AXIS_PTS_REF AXIS_KFVSKG_X /end AXIS_DESCR
/end CHARACTERISTIC
/begin CHARACTERISTIC REDZEM "Schwelle zwischen Zündeingriff und Einspritzausblendung" CURVE 0x019006 RL_UBYTE 0 CM_IDENT_UNIT_0 0.0 255.0
 /begin AXIS_DESCR COM_AXIS NO_INPUT_QUANTITY CM_IDENT_UNIT_0 5 0.0 255.0 AXIS_PTS_REF AXIS_REDZEM_X /end AXIS_DESCR
/end CHARACTERISTIC
/begin CHARACTERISTIC CWVSV "Codewort für Deaktivierung VS_VERST (CWVSV = 0: VS_VERST nicht aktiv)" CURVE 0x019071 RL_UBYTE 0 CM_IDENT_UNIT_0 0.0 255.0
 /begin AXIS_DESCR COM_AXIS NO_INPUT_QUANTITY CM_IDENT_UNIT_0 8 0.0 255.0 AXIS_PTS_REF AXIS_CWVSV_X /end AXIS_DESCR
/end CHARACTERISTIC
/begin CHARACTERISTIC KFTEVP "EVAP Tank Ventilation Purge Valve Period" MAP 0x0190C3 RL_UBYTE 0 CM_LIN_ms_period_65 0.0 127.5
 /begin AXIS_DESCR COM_AXIS NO_INPUT_QUANTITY CM_LIN_nmot_RPM_3 5 0.0 10200.0 AXIS_PTS_REF AXIS_KFTEVP_X /end AXIS_DESCR
 /begin AXIS_DESCR COM_AXIS NO_INPUT_QUANTITY CM_LIN_tateroh_purge_fl_6 9 0.0 100.0 AXIS_PTS_REF AXIS_KFTEVP_Y /end AXIS_DESCR
/end CHARACTERISTIC
/begin CHARACTERISTIC FBTEVA "Faktor ftefva-abhängige Lerngeschwindigkeit der Beladung" CURVE 0x019112 RL_UBYTE 0 CM_LIN_UNIT_54 0.0 0.9961
 /begin AXIS_DESCR COM_AXIS NO_INPUT_QUANTITY CM_IDENT_UNIT_0 6 0.0 255.0 AXIS_PTS_REF AXIS_FBTEVA_X /end AXIS_DESCR
/end CHARACTERISTIC
/begin CHARACTERISTIC KLDYNCOR "Wert für Dynamikkorrektur nach der ersten Zündung" CURVE 0x0191AB RL_UBYTE 0 CM_IDENT_us_66 0.0 255.0
 /begin AXIS_DESCR COM_AXIS NO_INPUT_QUANTITY CM_IDENT_UNIT_0 4 0.0 255.0 AXIS_PTS_REF AXIS_KLDYNCOR_X /end AXIS_DESCR
/end CHARACTERISTIC
/begin CHARACTERISTIC KFTATX "Kennfeld für maximales Tastverhältnis" MAP 0x0191F9 RL_UBYTE 0 CM_LIN_UNIT_40 0.0 99.6094
 /begin AXIS_DESCR COM_AXIS NO_INPUT_QUANTITY CM_IDENT_UNIT_0 10 0.0 255.0 AXIS_PTS_REF AXIS_KFTATX_X /end AXIS_DESCR
 /begin AXIS_DESCR COM_AXIS NO_INPUT_QUANTITY CM_IDENT_UNIT_0 6 0.0 255.0 AXIS_PTS_REF AXIS_KFTATX_Y /end AXIS_DESCR
/end CHARACTERISTIC
/begin CHARACTERISTIC ZVNWVSR "ZVNWVSR" CURVE 0x0192DA RL_UBYTE 0 CM_LIN_s_33 0.0 5.1
 /begin AXIS_DESCR COM_AXIS NO_INPUT_QUANTITY CM_IDENT_UNIT_0 8 0.0 255.0 AXIS_PTS_REF AXIS_ZVNWVSR_X /end AXIS_DESCR
/end CHARACTERISTIC
/begin CHARACTERISTIC FMSTMOT "tmot- Korrektur der Sekundärluftmasse" CURVE 0x01935C RL_UBYTE 0 CM_LIN_UNIT_29 0.0 1.9922
 /begin AXIS_DESCR COM_AXIS NO_INPUT_QUANTITY CM_IDENT_UNIT_0 8 0.0 255.0 AXIS_PTS_REF AXIS_FMSTMOT_X /end AXIS_DESCR
/end CHARACTERISTIC
/begin CHARACTERISTIC KFTATM "Kennfeld Abgastemperatur   f(nmot,rl)" MAP 0x019468 RL_UBYTE 0 CM_IDENT_Grad_C_32 0.0 255.0
 /begin AXIS_DESCR COM_AXIS NO_INPUT_QUANTITY CM_LIN_nmot_ub_q40_7 8 0.0 10200.0 AXIS_PTS_REF AXIS_KFTATM_X /end AXIS_DESCR
 /begin AXIS_DESCR COM_AXIS NO_INPUT_QUANTITY CM_LIN_rel_ub_q0p75_8 8 0.0 191.25 AXIS_PTS_REF AXIS_KFTATM_Y /end AXIS_DESCR
/end CHARACTERISTIC
/begin CHARACTERISTIC KFTATM2 "Kennfeld Abgastemperatur f(nmot,rl) Bank2" MAP 0x0194BA RL_UBYTE 0 CM_IDENT_Grad_C_32 0.0 255.0
 /begin AXIS_DESCR COM_AXIS NO_INPUT_QUANTITY CM_LIN_nmot_ub_q40_7 8 0.0 10200.0 AXIS_PTS_REF AXIS_KFTATM2_X /end AXIS_DESCR
 /begin AXIS_DESCR COM_AXIS NO_INPUT_QUANTITY CM_LIN_rel_ub_q0p75_8 8 0.0 191.25 AXIS_PTS_REF AXIS_KFTATM2_Y /end AXIS_DESCR
/end CHARACTERISTIC
/begin CHARACTERISTIC TFKWAVTMS "Timeout-Schwelle für Freigabe Diagn. bei Fehler Bed. Kühlw.-Absperrventil B_kwav" CURVE 0x019508 RL_UBYTE 0 CM_IDENT_s_27 0.0 255.0
 /begin AXIS_DESCR COM_AXIS NO_INPUT_QUANTITY CM_IDENT_UNIT_0 4 0.0 255.0 AXIS_PTS_REF AXIS_TFKWAVTMS_X /end AXIS_DESCR
/end CHARACTERISTIC
/begin CHARACTERISTIC KFRINH "Catalytic Converter Internal Flow Resistance Model Bank 1" MAP 0x01956F RL_UBYTE 0 CM_LIN_ohms_resistance_67 0.0 2040.0
 /begin AXIS_DESCR COM_AXIS NO_INPUT_QUANTITY CM_LIN_tkatmf_temp_deg__9 5 -50.0 1225.0 AXIS_PTS_REF AXIS_KFRINH_X /end AXIS_DESCR
 /begin AXIS_DESCR COM_AXIS NO_INPUT_QUANTITY CM_LIN_phlsnhf_flow_fac_10 3 0.0 2.55 AXIS_PTS_REF AXIS_KFRINH_Y /end AXIS_DESCR
/end CHARACTERISTIC
/begin CHARACTERISTIC KFRINH2 "Catalytic Converter Internal Flow Resistance Model Bank 2" MAP 0x019588 RL_UBYTE 0 CM_LIN_ohms_resistance_67 0.0 2040.0
 /begin AXIS_DESCR COM_AXIS NO_INPUT_QUANTITY CM_LIN_tkatmf2_temp_deg_11 5 -50.0 1225.0 AXIS_PTS_REF AXIS_KFRINH2_X /end AXIS_DESCR
 /begin AXIS_DESCR COM_AXIS NO_INPUT_QUANTITY CM_LIN_phlsnhf2_flow_fa_12 3 0.0 2.55 AXIS_PTS_REF AXIS_KFRINH2_Y /end AXIS_DESCR
/end CHARACTERISTIC
/begin CHARACTERISTIC AZKRNDYN "Number of Ignitions for Knock Control Engine Speed Dynamics" VALUE 0x0195A9 RL_UBYTE 0 CM_IDENT_ignitions_68 0.0 255.0 /end CHARACTERISTIC
/begin CHARACTERISTIC CWKR "Knock Control Configuration Codeword" VALUE 0x0195B9 RL_UBYTE 0 CM_IDENT_codeword_69 0.0 255.0 /end CHARACTERISTIC
/begin CHARACTERISTIC NKRUM "RPM Threshold for Delta-Load Signal Switching in Dynamic Knock" VALUE 0x0195BA RL_UBYTE 0 CM_LIN_RPM_70 0.0 10200.0 /end CHARACTERISTIC
/begin CHARACTERISTIC CWKR2 "Knock Control Secondary Configuration Codeword" VALUE 0x0195BB RL_UBYTE 0 CM_IDENT_codeword_69 0.0 255.0 /end CHARACTERISTIC
/begin CHARACTERISTIC KFVSGK "Faktor Abmagerung bei Wechsel Ventilhub groß nach klein" CURVE 0x0195D1 RL_UBYTE 0 CM_LIN_UNIT_61 0.0 3.9844
 /begin AXIS_DESCR COM_AXIS NO_INPUT_QUANTITY CM_IDENT_UNIT_0 8 0.0 255.0 AXIS_PTS_REF AXIS_KFVSGK_X /end AXIS_DESCR
/end CHARACTERISTIC
/begin CHARACTERISTIC KFZW4 "Zündwinkelkennfeld Variante 4" CURVE 0x01964D RL_UBYTE 0 CM_IDENT_grad_KW_59 0.0 255.0
 /begin AXIS_DESCR COM_AXIS NO_INPUT_QUANTITY CM_IDENT_UNIT_0 4 0.0 255.0 AXIS_PTS_REF AXIS_KFZW4_X /end AXIS_DESCR
/end CHARACTERISTIC
/begin CHARACTERISTIC KFMRES "Idle Speed Control Stability Torque Reserve" MAP 0x019698 RL_UBYTE 0 CM_LIN_torque_reserve_71 0.0 1.9922
 /begin AXIS_DESCR COM_AXIS NO_INPUT_QUANTITY CM_LIN_nmot_RPM_3 10 0.0 10200.0 AXIS_PTS_REF AXIS_KFMRES_X /end AXIS_DESCR
 /begin AXIS_DESCR COM_AXIS NO_INPUT_QUANTITY CM_LIN_mifa_torque_13 8 0.0 1.9922 AXIS_PTS_REF AXIS_KFMRES_Y /end AXIS_DESCR
/end CHARACTERISTIC
/begin CHARACTERISTIC KFLURBZ "Kennfeld für Laufunruhe-Referenz-Basiswert bei ZAS" CURVE 0x01978D RL_UBYTE 0 CM_IDENT_Umdr_sec_2_38 0.0 255.0
 /begin AXIS_DESCR COM_AXIS NO_INPUT_QUANTITY CM_IDENT_UNIT_0 6 0.0 255.0 AXIS_PTS_REF AXIS_KFLURBZ_X /end AXIS_DESCR
/end CHARACTERISTIC
/begin CHARACTERISTIC TNWSUK1 "Verzögerungszeit für Krafstoffkorrekturfaktor duch NWS" CURVE 0x0197FA RL_UBYTE 0 CM_IDENT_s_27 0.0 255.0
 /begin AXIS_DESCR COM_AXIS NO_INPUT_QUANTITY CM_IDENT_UNIT_0 6 0.0 255.0 AXIS_PTS_REF AXIS_TNWSUK1_X /end AXIS_DESCR
/end CHARACTERISTIC
/begin CHARACTERISTIC TVVSES "Verzögerungszeit Einspritzungskorrektur bei Wechsel von klein --> groß" CURVE 0x0198E5 RL_UBYTE 0 CM_IDENT_s_27 0.0 255.0
 /begin AXIS_DESCR COM_AXIS NO_INPUT_QUANTITY CM_IDENT_UNIT_0 8 0.0 255.0 AXIS_PTS_REF AXIS_TVVSES_X /end AXIS_DESCR
/end CHARACTERISTIC
/begin CHARACTERISTIC FKKVS "Fuel Supply / Rail Flow Correction Factor Matrix" MAP 0x019910 RL_UBYTE 0 CM_LIN_correction_facto_72 0.0 1.9922
 /begin AXIS_DESCR COM_AXIS NO_INPUT_QUANTITY CM_LIN_nmot_RPM_3 16 0.0 10200.0 AXIS_PTS_REF AXIS_FKKVS_X /end AXIS_DESCR
 /begin AXIS_DESCR COM_AXIS NO_INPUT_QUANTITY CM_LIN_tevfa_inj_time_r_14 16 0.0 1.9922 AXIS_PTS_REF AXIS_FKKVS_Y /end AXIS_DESCR
/end CHARACTERISTIC
/begin CHARACTERISTIC FFWK "Kennlinie Faktor Nockenwelle kaltverstellt" CURVE 0x019A1C RL_UBYTE 0 CM_LIN_UNIT_29 0.0 1.9922
 /begin AXIS_DESCR COM_AXIS NO_INPUT_QUANTITY CM_IDENT_UNIT_0 5 0.0 255.0 AXIS_PTS_REF AXIS_FFWK_X /end AXIS_DESCR
/end CHARACTERISTIC
/begin CHARACTERISTIC KLDNFHO "Wichtung Minimaler Drehzahlanstieg für erkannte Verbrennung" CURVE 0x019A62 RL_UBYTE 0 CM_LIN_UNIT_29 0.0 1.9922
 /begin AXIS_DESCR COM_AXIS NO_INPUT_QUANTITY CM_IDENT_UNIT_0 4 0.0 255.0 AXIS_PTS_REF AXIS_KLDNFHO_X /end AXIS_DESCR
/end CHARACTERISTIC
/begin CHARACTERISTIC NASNOTKL "Kennlinie für Drehzahlschwelle für Abwürgeschutz" CURVE 0x019CAB RL_UBYTE 0 CM_IDENT_Upm_41 0.0 255.0
 /begin AXIS_DESCR COM_AXIS NO_INPUT_QUANTITY CM_IDENT_UNIT_0 4 0.0 255.0 AXIS_PTS_REF AXIS_NASNOTKL_X /end AXIS_DESCR
/end CHARACTERISTIC
/begin CHARACTERISTIC TNWSUK2 "Haltezeit des Krafstoffkorrekturfaktors durch NWS bis abgeregelt wird" CURVE 0x019F14 RL_UBYTE 0 CM_IDENT_s_27 0.0 255.0
 /begin AXIS_DESCR COM_AXIS NO_INPUT_QUANTITY CM_IDENT_UNIT_0 6 0.0 255.0 AXIS_PTS_REF AXIS_TNWSUK2_X /end AXIS_DESCR
/end CHARACTERISTIC
/begin CHARACTERISTIC LMSTMOT "Motortemp.-Korrektur von Lambda-Motor-Soll" CURVE 0x019F51 RL_UBYTE 0 CM_LIN_UNIT_29 0.0 1.9922
 /begin AXIS_DESCR COM_AXIS NO_INPUT_QUANTITY CM_IDENT_UNIT_0 4 0.0 255.0 AXIS_PTS_REF AXIS_LMSTMOT_X /end AXIS_DESCR
/end CHARACTERISTIC
/begin CHARACTERISTIC DTLRTML "Bewertungsfaktor Zeitdekrementierung für Erreichen tmot-Einschaltschwelle LR" CURVE 0x019F8C RL_UBYTE 0 CM_LIN_UNIT_40 0.0 99.6094
 /begin AXIS_DESCR COM_AXIS NO_INPUT_QUANTITY CM_IDENT_UNIT_0 7 0.0 255.0 AXIS_PTS_REF AXIS_DTLRTML_X /end AXIS_DESCR
/end CHARACTERISTIC
/begin CHARACTERISTIC TWLRTMS "Wartezeit für Diagnose TMOT-Einschaltbedingung lambda-Regelung" CURVE 0x019FD6 RL_UBYTE 0 CM_IDENT_s_27 0.0 255.0
 /begin AXIS_DESCR COM_AXIS NO_INPUT_QUANTITY CM_IDENT_UNIT_0 4 0.0 255.0 AXIS_PTS_REF AXIS_TWLRTMS_X /end AXIS_DESCR
/end CHARACTERISTIC
/begin CHARACTERISTIC DNLBZFS "Leerlauf-Solldrehzahlanhebung für Batterie-Ladebilanz" CURVE 0x01A006 RL_UBYTE 0 CM_IDENT_U_min_55 0.0 255.0
 /begin AXIS_DESCR COM_AXIS NO_INPUT_QUANTITY CM_IDENT_UNIT_0 6 0.0 255.0 AXIS_PTS_REF AXIS_DNLBZFS_X /end AXIS_DESCR
/end CHARACTERISTIC
/begin CHARACTERISTIC TVVSESL "Verzögerungszeit Gemischkorrektur bei Wechsel von groß --> klein" CURVE 0x01A02C RL_UBYTE 0 CM_IDENT_s_27 0.0 255.0
 /begin AXIS_DESCR COM_AXIS NO_INPUT_QUANTITY CM_IDENT_UNIT_0 8 0.0 255.0 AXIS_PTS_REF AXIS_TVVSESL_X /end AXIS_DESCR
/end CHARACTERISTIC
/begin CHARACTERISTIC FTMLAKH "tmot-Korrektur der Lambda-Bewertung bei Katheizen" CURVE 0x01A03D RL_UBYTE 0 CM_LIN_UNIT_54 0.0 0.9961
 /begin AXIS_DESCR COM_AXIS NO_INPUT_QUANTITY CM_IDENT_UNIT_0 4 0.0 255.0 AXIS_PTS_REF AXIS_FTMLAKH_X /end AXIS_DESCR
/end CHARACTERISTIC
/begin CHARACTERISTIC KFSZT "Schließzeit-Kennfeld" MAP 0x01A08F RL_UBYTE 0 CM_LIN_ms_73 0.0 25.5
 /begin AXIS_DESCR COM_AXIS NO_INPUT_QUANTITY CM_LIN_spg_ubatt_15 8 0.0 19.38 AXIS_PTS_REF AXIS_KFSZT_X /end AXIS_DESCR
 /begin AXIS_DESCR COM_AXIS NO_INPUT_QUANTITY CM_LIN_nmot_ub_q40_7 8 0.0 10200.0 AXIS_PTS_REF AXIS_KFSZT_Y /end AXIS_DESCR
/end CHARACTERISTIC
/begin CHARACTERISTIC MVER_T_UM "Fehlerzeit beim Momentenvergleich in der Funktionsüberwachung" CURVE 0x01A0D8 RL_UBYTE 0 CM_IDENT_ms_43 0.0 255.0
 /begin AXIS_DESCR COM_AXIS NO_INPUT_QUANTITY CM_IDENT_UNIT_0 8 0.0 255.0 AXIS_PTS_REF AXIS_MVER_T_UM_X /end AXIS_DESCR
/end CHARACTERISTIC
/begin CHARACTERISTIC FTVVSV "Faktor Schaltzeitverkürzung bei starkem Drehmomentanstieg" CURVE 0x01A12A RL_UBYTE 0 CM_LIN_UNIT_54 0.0 0.9961
 /begin AXIS_DESCR COM_AXIS NO_INPUT_QUANTITY CM_IDENT_UNIT_0 8 0.0 255.0 AXIS_PTS_REF AXIS_FTVVSV_X /end AXIS_DESCR
/end CHARACTERISTIC
/begin CHARACTERISTIC AZKRLDYN "Anzahl Zündungen pro Zyl. bei KR-Lastdynamik" CURVE 0x01A15A RL_UBYTE 0 CM_IDENT_UNIT_0 0.0 255.0
 /begin AXIS_DESCR COM_AXIS NO_INPUT_QUANTITY CM_IDENT_UNIT_0 15 0.0 255.0 AXIS_PTS_REF AXIS_AZKRLDYN_X /end AXIS_DESCR
/end CHARACTERISTIC
/begin CHARACTERISTIC ZSYNAUSW "Anzahl Zündungen (Synchros) bis Auswerten" CURVE 0x01A29A RL_UBYTE 0 CM_IDENT_UNIT_0 0.0 255.0
 /begin AXIS_DESCR COM_AXIS NO_INPUT_QUANTITY CM_IDENT_UNIT_0 4 0.0 255.0 AXIS_PTS_REF AXIS_ZSYNAUSW_X /end AXIS_DESCR
/end CHARACTERISTIC
/begin CHARACTERISTIC TABGMEX "Abgastemperatur unterhalb der Kat-Anspringtemperatur" CURVE 0x01A34C RL_UBYTE 0 CM_IDENT_Grad_C_32 0.0 255.0
 /begin AXIS_DESCR COM_AXIS NO_INPUT_QUANTITY CM_IDENT_UNIT_0 5 0.0 255.0 AXIS_PTS_REF AXIS_TABGMEX_X /end AXIS_DESCR
/end CHARACTERISTIC
/begin CHARACTERISTIC KFMDKO "Drehmomentaufnahme Klimakompressor" MAP 0x01A37A RL_UBYTE 0 CM_LIN_UNIT_74 0.0 49.725
 /begin AXIS_DESCR COM_AXIS NO_INPUT_QUANTITY CM_LIN_nmot_ub_q40_7 6 0.0 10200.0 AXIS_PTS_REF AXIS_KFMDKO_X /end AXIS_DESCR
 /begin AXIS_DESCR COM_AXIS NO_INPUT_QUANTITY CM_IDENT_dez_16 8 0.0 255.0 AXIS_PTS_REF AXIS_KFMDKO_Y /end AXIS_DESCR
/end CHARACTERISTIC
/begin CHARACTERISTIC KINMXRLG "Verstärkung Integralanteil der NMAX-Regelung im Normalbetrieb" MAP 0x01A43D RL_UBYTE 0 CM_IDENT_U_min_s_75 0.0 255.0
 /begin AXIS_DESCR COM_AXIS NO_INPUT_QUANTITY CM_LIN_rel_ub_q0p75_8 8 0.0 191.25 AXIS_PTS_REF AXIS_KINMXRLG_X /end AXIS_DESCR
 /begin AXIS_DESCR COM_AXIS NO_INPUT_QUANTITY CM_IDENT_dez_16 8 0.0 255.0 AXIS_PTS_REF AXIS_KINMXRLG_Y /end AXIS_DESCR
/end CHARACTERISTIC
/begin CHARACTERISTIC CDATR "Configuration Byte Diagnosis Exhaust Gas Temperature Control" VALUE 0x01A49C RL_UBYTE 0 CM_IDENT_flag_0_off_1_on_76 0.0 255.0 /end CHARACTERISTIC
/begin CHARACTERISTIC CDTES "EVAP / Fuel Tank Ventilation Diagnostic Enable Codeword" VALUE 0x01A49D RL_UBYTE 0 CM_IDENT_flag_0_off_1_on_76 0.0 255.0 /end CHARACTERISTIC
/begin CHARACTERISTIC CDDST "CARB Euro Byte for Tank Pressure Sensor Diagnosis Deactivation" VALUE 0x01A49E RL_UBYTE 0 CM_IDENT_flag_0_off_1_on_76 0.0 255.0 /end CHARACTERISTIC
/begin CHARACTERISTIC CDKAT "Catalytic Converter OBD-II Diagnosis Enable Codeword" VALUE 0x01A4A2 RL_UBYTE 0 CM_IDENT_flag_0_off_1_on_76 0.0 255.0 /end CHARACTERISTIC
/begin CHARACTERISTIC CDSLS "Secondary Air Injection (SAI) Diagnosis Enable Codeword" VALUE 0x01A4A3 RL_UBYTE 0 CM_IDENT_flag_0_off_1_on_76 0.0 255.0 /end CHARACTERISTIC
/begin CHARACTERISTIC CDHSH "Rear O2 Sensor Heater Diagnostic Enable Codeword" VALUE 0x01A4A7 RL_UBYTE 0 CM_IDENT_flag_0_off_1_on_76 0.0 255.0 /end CHARACTERISTIC
/begin CHARACTERISTIC CDLSH "Rear O2 Sensor Operational Diagnostic Enable Codeword" VALUE 0x01A4B2 RL_UBYTE 0 CM_IDENT_flag_0_off_1_on_76 0.0 255.0 /end CHARACTERISTIC
/begin CHARACTERISTIC KFDETATE "Zündwinkelwirkungsgrad Korrektur for DTEV" MAP 0x01A4E2 RL_UBYTE 0 CM_LIN_UNIT_77 0.0 127.5
 /begin AXIS_DESCR COM_AXIS NO_INPUT_QUANTITY CM_LIN_rel_ub_b127p5_17 4 0.0 127.5 AXIS_PTS_REF AXIS_KFDETATE_X /end AXIS_DESCR
 /begin AXIS_DESCR COM_AXIS NO_INPUT_QUANTITY CM_LIN_m_q0p1_18 6 0.0 25.5 AXIS_PTS_REF AXIS_KFDETATE_Y /end AXIS_DESCR
/end CHARACTERISTIC
/begin CHARACTERISTIC KFTVFRR "Kennfeld: Lambda-Regler nach dieser Zeit auf Referenzwert zurücksetzen" MAP 0x01A503 RL_UBYTE 0 CM_LIN_s_78 0.0 25.5
 /begin AXIS_DESCR COM_AXIS NO_INPUT_QUANTITY CM_LIN_rel_ub_b99p6_19 4 0.0 99.6094 AXIS_PTS_REF AXIS_KFTVFRR_X /end AXIS_DESCR
 /begin AXIS_DESCR COM_AXIS NO_INPUT_QUANTITY CM_LIN_m_ub_b1020_20 3 0.0 1020.0 AXIS_PTS_REF AXIS_KFTVFRR_Y /end AXIS_DESCR
/end CHARACTERISTIC
/begin CHARACTERISTIC TADTEAMX "Kennlinie Max. tastverhältnis abhängig vom Integral Massenstrom TE nach TE Stop" CURVE 0x01A51E RL_UBYTE 0 CM_IDENT_UNIT_34 0.0 255.0
 /begin AXIS_DESCR COM_AXIS NO_INPUT_QUANTITY CM_IDENT_UNIT_0 14 0.0 255.0 AXIS_PTS_REF AXIS_TADTEAMX_X /end AXIS_DESCR
/end CHARACTERISTIC
/begin CHARACTERISTIC FFRITMS "Faktor für I-Dynamik des Lambdareglers in Abhängigkeit von tmst" CURVE 0x01A545 RL_UBYTE 0 CM_LIN_UNIT_54 0.0 0.9961
 /begin AXIS_DESCR COM_AXIS NO_INPUT_QUANTITY CM_IDENT_UNIT_0 4 0.0 255.0 AXIS_PTS_REF AXIS_FFRITMS_X /end AXIS_DESCR
/end CHARACTERISTIC
/begin CHARACTERISTIC KFRI "I - Kennfeld" CURVE 0x01A54F RL_UBYTE 0 CM_IDENT_s_79 0.0 255.0
 /begin AXIS_DESCR COM_AXIS NO_INPUT_QUANTITY CM_IDENT_UNIT_0 5 0.0 255.0 AXIS_PTS_REF AXIS_KFRI_X /end AXIS_DESCR
/end CHARACTERISTIC
/begin CHARACTERISTIC KFRI2 "LR-I-Kennfeld für Bank 2" CURVE 0x01A579 RL_UBYTE 0 CM_IDENT_s_79 0.0 255.0
 /begin AXIS_DESCR COM_AXIS NO_INPUT_QUANTITY CM_IDENT_UNIT_0 5 0.0 255.0 AXIS_PTS_REF AXIS_KFRI2_X /end AXIS_DESCR
/end CHARACTERISTIC
/begin CHARACTERISTIC RLLRUN "Kennlinie über nmot, untere rL Regelgrenze für Regler vor KAT" CURVE 0x01A651 RL_UBYTE 0 CM_IDENT_UNIT_34 0.0 255.0
 /begin AXIS_DESCR COM_AXIS NO_INPUT_QUANTITY CM_IDENT_UNIT_0 8 0.0 255.0 AXIS_PTS_REF AXIS_RLLRUN_X /end AXIS_DESCR
/end CHARACTERISTIC
/begin CHARACTERISTIC ZLRHML "Luftmassendurchsatz abhängige Zeitkonstante für Lambdaregler hinter Katalysator" CURVE 0x01A729 RL_UBYTE 0 CM_LIN_ms_s_80 0.0 9.9609
 /begin AXIS_DESCR COM_AXIS NO_INPUT_QUANTITY CM_IDENT_UNIT_0 6 0.0 255.0 AXIS_PTS_REF AXIS_ZLRHML_X /end AXIS_DESCR
/end CHARACTERISTIC
/begin CHARACTERISTIC FIMALU "Filterfaktor Mehrfachaussetzererkennung" CURVE 0x01A73D RL_UBYTE 0 CM_LIN_UNIT_54 0.0 0.9961
 /begin AXIS_DESCR COM_AXIS NO_INPUT_QUANTITY CM_IDENT_UNIT_0 5 0.0 255.0 AXIS_PTS_REF AXIS_FIMALU_X /end AXIS_DESCR
/end CHARACTERISTIC
/begin CHARACTERISTIC FKAXAVKAT "Gewichtungsfaktor Sauerstoffspeicher in Abhängigkeit von avkatf" CURVE 0x01A780 RL_UBYTE 0 CM_LIN_UNIT_54 0.0 0.9961
 /begin AXIS_DESCR COM_AXIS NO_INPUT_QUANTITY CM_IDENT_UNIT_0 5 0.0 255.0 AXIS_PTS_REF AXIS_FKAXAVKAT_X /end AXIS_DESCR
/end CHARACTERISTIC
/begin CHARACTERISTIC FQTEFR "Kennlinie stetige Grenzwertregelung (fr)" CURVE 0x01A78F RL_UBYTE 0 CM_LIN_UNIT_81 0.0 31.875
 /begin AXIS_DESCR COM_AXIS NO_INPUT_QUANTITY CM_IDENT_UNIT_0 8 0.0 255.0 AXIS_PTS_REF AXIS_FQTEFR_X /end AXIS_DESCR
/end CHARACTERISTIC
/begin CHARACTERISTIC KFURL "Manifold Pressure to Load Factor vs VarioCam Angle (BGSRM)" MAP 0x01A9EC RL_UWORD 0 CM_LIN_factor_82 0.0 0.3
 /begin AXIS_DESCR COM_AXIS NO_INPUT_QUANTITY CM_LIN_wnwue_w_cam_deg__21 6 0.0 124.5165 AXIS_PTS_REF AXIS_KFURL_X /end AXIS_DESCR
 /begin AXIS_DESCR COM_AXIS NO_INPUT_QUANTITY CM_LIN_nmot_w_RPM_22 10 0.0 16383.75 AXIS_PTS_REF AXIS_KFURL_Y /end AXIS_DESCR
/end CHARACTERISTIC
/begin CHARACTERISTIC DNLBZ "Leerlauf-Solldrehzahlanhebung für Batterie-Ladebilanz" CURVE 0x01B405 RL_UBYTE 0 CM_IDENT_U_min_55 0.0 255.0
 /begin AXIS_DESCR COM_AXIS NO_INPUT_QUANTITY CM_IDENT_UNIT_0 6 0.0 255.0 AXIS_PTS_REF AXIS_DNLBZ_X /end AXIS_DESCR
/end CHARACTERISTIC
/begin CHARACTERISTIC KFDTMTU "Kennfeld Korrekturgradient Motortemperatur bei geringer Erwärmung" MAP 0x01B963 RL_UBYTE 0 CM_IDENT_Grad_C_32 0.0 255.0
 /begin AXIS_DESCR COM_AXIS NO_INPUT_QUANTITY CM_IDENT_UNIT_0 5 0.0 255.0 AXIS_PTS_REF AXIS_KFDTMTU_X /end AXIS_DESCR
 /begin AXIS_DESCR COM_AXIS NO_INPUT_QUANTITY CM_IDENT_UNIT_0 4 0.0 255.0 AXIS_PTS_REF AXIS_KFDTMTU_Y /end AXIS_DESCR
/end CHARACTERISTIC
/begin CHARACTERISTIC IMLLASKH "imlpr-Schwelle für Übergang auf Lambda-Abgas-Vorgabe" CURVE 0x01B97E RL_UBYTE 0 CM_LIN_UNIT_54 0.0 0.9961
 /begin AXIS_DESCR COM_AXIS NO_INPUT_QUANTITY CM_IDENT_UNIT_0 5 0.0 255.0 AXIS_PTS_REF AXIS_IMLLASKH_X /end AXIS_DESCR
/end CHARACTERISTIC
/begin CHARACTERISTIC KFTSRL "Ignition Coil Dwell Time / Primary Charge Duration Surface" MAP 0x01BC4A RL_UWORD 0 CM_LIN_ms_dwell_83 0.0 655.35
 /begin AXIS_DESCR COM_AXIS NO_INPUT_QUANTITY CM_LIN_ub_battery_V_23 6 0.0 159.9976 AXIS_PTS_REF AXIS_KFTSRL_X /end AXIS_DESCR
 /begin AXIS_DESCR COM_AXIS NO_INPUT_QUANTITY CM_LIN_nmot_w_RPM_22 6 0.0 16383.75 AXIS_PTS_REF AXIS_KFTSRL_Y /end AXIS_DESCR
/end CHARACTERISTIC
/begin CHARACTERISTIC KFFRMIN "untere Regelbereichsgrenze" CURVE 0x01BD62 RL_UBYTE 0 CM_LIN_UNIT_84 0.0 0.0078
 /begin AXIS_DESCR COM_AXIS NO_INPUT_QUANTITY CM_IDENT_UNIT_0 5 0.0 255.0 AXIS_PTS_REF AXIS_KFFRMIN_X /end AXIS_DESCR
/end CHARACTERISTIC
/begin CHARACTERISTIC DZWAML "Auf/Abregelgeschwindigkeit zwischen den Begrenzungskennfeldern" CURVE 0x01BEBD RL_UBYTE 0 CM_IDENT_grad_KW_59 0.0 255.0
 /begin AXIS_DESCR COM_AXIS NO_INPUT_QUANTITY CM_IDENT_UNIT_0 12 0.0 255.0 AXIS_PTS_REF AXIS_DZWAML_X /end AXIS_DESCR
/end CHARACTERISTIC
/begin CHARACTERISTIC DLAMOB "Delta Lambda bei Overboost" CURVE 0x01BED3 RL_UBYTE 0 CM_IDENT_UNIT_0 0.0 255.0
 /begin AXIS_DESCR COM_AXIS NO_INPUT_QUANTITY CM_IDENT_UNIT_0 6 0.0 255.0 AXIS_PTS_REF AXIS_DLAMOB_X /end AXIS_DESCR
/end CHARACTERISTIC
/begin CHARACTERISTIC DMADFK "Maximal adaptierbares Delta-Verlustmoment pro Adaptionsphase Fahrst.+Kompr." CURVE 0x01BEE1 RL_UBYTE 0 CM_LIN_UNIT_85 0.0 24.9
 /begin AXIS_DESCR COM_AXIS NO_INPUT_QUANTITY CM_IDENT_UNIT_0 6 0.0 255.0 AXIS_PTS_REF AXIS_DMADFK_X /end AXIS_DESCR
/end CHARACTERISTIC
/begin CHARACTERISTIC KFZWWLTM "Warmup Ignition Timing Advance Delta" MAP 0x01BF02 RL_SBYTE 0 CM_LIN_deg_BTDC_delta_86 -96.0 95.25
 /begin AXIS_DESCR COM_AXIS NO_INPUT_QUANTITY CM_LIN_tmot_coolant_deg_1 12 -48.0 143.25 AXIS_PTS_REF AXIS_KFZWWLTM_X /end AXIS_DESCR
 /begin AXIS_DESCR COM_AXIS NO_INPUT_QUANTITY CM_LIN_tmst_start_deg_C_2 12 -48.0 143.25 AXIS_PTS_REF AXIS_KFZWWLTM_Y /end AXIS_DESCR
/end CHARACTERISTIC
/begin CHARACTERISTIC KFNWSE "Intake Camshaft Spread / VarioCam Phasing Map" MAP 0x01C114 RL_UWORD 0 CM_LIN_deg_KW_cam_sprea_87 0.0 511.9922
 /begin AXIS_DESCR COM_AXIS NO_INPUT_QUANTITY CM_LIN_nmot_w_RPM_22 16 0.0 16383.75 AXIS_PTS_REF AXIS_KFNWSE_X /end AXIS_DESCR
 /begin AXIS_DESCR COM_AXIS NO_INPUT_QUANTITY CM_LIN_rlnw_w_load_24 8 0.0 1535.9766 AXIS_PTS_REF AXIS_KFNWSE_Y /end AXIS_DESCR
/end CHARACTERISTIC
/begin CHARACTERISTIC VSL "Fahrzeuggeschwindigkeitsschwelle für Kompensation Servolenkung" CURVE 0x01CCA5 RL_UBYTE 0 CM_IDENT_km_h_88 0.0 255.0
 /begin AXIS_DESCR COM_AXIS NO_INPUT_QUANTITY CM_IDENT_UNIT_0 4 0.0 255.0 AXIS_PTS_REF AXIS_VSL_X /end AXIS_DESCR
/end CHARACTERISTIC
/begin CHARACTERISTIC CDCTESK "Codewort CARB: Tankentlüftungssystem Kleinstleck" VALUE 0x014B5C RL_UWORD 0 CM_IDENT_UNIT_0 0.0 65535.0 /end CHARACTERISTIC
/begin CHARACTERISTIC CDCTESF "Codewort CARB: Tankentlüftungssystem Feinleck" VALUE 0x014B4C RL_UWORD 0 CM_IDENT_UNIT_0 0.0 65535.0 /end CHARACTERISTIC
/begin CHARACTERISTIC CDCTHM "Codewort CARB: Thermostat-Diagnose THM" VALUE 0x014B7C RL_UWORD 0 CM_IDENT_UNIT_0 0.0 65535.0 /end CHARACTERISTIC
/begin CHARACTERISTIC CLAEV4 "Fehlerklasse: EV Endstufe 4" VALUE 0x010830 RL_UBYTE 0 CM_IDENT_UNIT_0 0.0 255.0 /end CHARACTERISTIC
/begin CHARACTERISTIC CDTDVEE "Codewort Tester: DV-E Endstufe" VALUE 0x0148B0 RL_UWORD 0 CM_IDENT_UNIT_0 0.0 65535.0 /end CHARACTERISTIC
/begin CHARACTERISTIC CLAKPE "Fehlerklasse: EKP-Relais Endstufe" VALUE 0x01083B RL_UBYTE 0 CM_IDENT_UNIT_0 0.0 255.0 /end CHARACTERISTIC
/begin CHARACTERISTIC CLAKS2 "Fehlerklasse: Klopfsensor 2" VALUE 0x010844 RL_UBYTE 0 CM_IDENT_UNIT_0 0.0 255.0 /end CHARACTERISTIC
/begin CHARACTERISTIC SHKNWMXE "Maximale Anzahl Schüttelversuche Einlaßnockenwelle im Fahrzyklus" VALUE 0x0122C2 RL_UBYTE 0 CM_IDENT_UNIT_0 0.0 255.0 /end CHARACTERISTIC
/begin CHARACTERISTIC WAD1T0 "Wichtungsfaktor Adaptionsbereich 1 zu 0" VALUE 0x011643 RL_UBYTE 0 CM_LIN_UNIT_89 0.0 15.9375 /end CHARACTERISTIC
/begin CHARACTERISTIC SRYHS "Schwelle für Readiness-Bildung Sondenheizungs-Diagnose" VALUE 0x01155D RL_UBYTE 0 CM_IDENT_UNIT_0 0.0 255.0 /end CHARACTERISTIC
/begin CHARACTERISTIC TSFKS1 "Fehlersummenzeit: Klopfsensor 1" VALUE 0x011509 RL_UBYTE 0 CM_IDENT_UNIT_0 0.0 255.0 /end CHARACTERISTIC
/begin CHARACTERISTIC UBDCAN "UBatt-Schwelle für Diagnose CAN-Timeout" VALUE 0x010023 RL_UBYTE 0 CM_LIN_UNIT_90 0.0 19.38 /end CHARACTERISTIC
/begin CHARACTERISTIC TUPWG1U "Fehlerzeit bei Bereichsverletzung von PWG-Poti 1 nach unten" VALUE 0x0117C6 RL_UBYTE 0 CM_LIN_UNIT_91 0.0 2.55 /end CHARACTERISTIC
/begin CHARACTERISTIC CLAVFZ "Fehlerklasse: Geschwindigkeitssignal" VALUE 0x010020 RL_UBYTE 0 CM_IDENT_UNIT_0 0.0 255.0 /end CHARACTERISTIC
/begin CHARACTERISTIC DTAHLL "Delta Ansauglufttemperatur für Abbruch erhöhte Solldrehzahl im Heiß-Leerlauf" VALUE 0x0117F3 RL_UBYTE 0 CM_LIN_UNIT_92 0.0 191.25 /end CHARACTERISTIC
/begin CHARACTERISTIC DWDK12O "Maximal zulässige Abweichung zwischen den DK-Winkeln aus Poti 1 und 2" VALUE 0x011CD6 RL_UBYTE 0 CM_LIN_UNIT_93 0.0 100.0 /end CHARACTERISTIC
/begin CHARACTERISTIC CDTBREMS "Fehlerpfadcode: BREMS (Bremsschalter)" VALUE 0x01400C RL_UWORD 0 CM_IDENT_UNIT_0 0.0 65535.0 /end CHARACTERISTIC
/begin CHARACTERISTIC TSFMD03 "Fehlersummenzeit: Aussetzer Zylinder 3" VALUE 0x011521 RL_UBYTE 0 CM_IDENT_UNIT_0 0.0 255.0 /end CHARACTERISTIC
/begin CHARACTERISTIC CLATGET "Fehlerklasse: Getriebetemperatur TGET" VALUE 0x010013 RL_UBYTE 0 CM_IDENT_UNIT_0 0.0 255.0 /end CHARACTERISTIC
/begin CHARACTERISTIC TMHLL "Motortemperaturschwelle für erhöhte Solldrehzahl im Heiß-Leerlauf" VALUE 0x01285E RL_UBYTE 0 CM_LIN_UNIT_94 -48.0 143.25 /end CHARACTERISTIC
/begin CHARACTERISTIC ZWAPPL "Applikationsschnittstelle Zündwinkelverstellung" VALUE 0x01250F RL_SBYTE 0 CM_LIN_UNIT_92 -96.0 95.25 /end CHARACTERISTIC
/begin CHARACTERISTIC TUPWG2U "Fehlerzeit bei Bereichsverletzung von PWG-Poti 2 nach unten" VALUE 0x0112C8 RL_UBYTE 0 CM_LIN_UNIT_91 0.0 2.55 /end CHARACTERISTIC
/begin CHARACTERISTIC CDCURRAM "Codewort CARB: Rechnerüberwachung: RAM" VALUE 0x014692 RL_UWORD 0 CM_IDENT_UNIT_0 0.0 65535.0 /end CHARACTERISTIC
/begin CHARACTERISTIC WDKNLPMI "unterer erlaubter Istwert für NLP-Stellung" VALUE 0x015050 RL_UWORD 0 CM_LIN_UNIT_95 0.0 99.9999 /end CHARACTERISTIC
/begin CHARACTERISTIC TSFLSV2 "Fehlersummenzeit: Lambda-Sonde 2 vor Kat" VALUE 0x01101C RL_UBYTE 0 CM_IDENT_UNIT_0 0.0 255.0 /end CHARACTERISTIC
/begin CHARACTERISTIC CDCVS1E "Codeword CARB: Ventilhub1 (Endstufe)" VALUE 0x014C14 RL_UWORD 0 CM_IDENT_UNIT_0 0.0 65535.0 /end CHARACTERISTIC
/begin CHARACTERISTIC CDTCGGGP "Codewort Tester: EGS; Gang unplausibel" VALUE 0x01487A RL_UWORD 0 CM_IDENT_UNIT_0 0.0 65535.0 /end CHARACTERISTIC
/begin CHARACTERISTIC CDCSLS "Codewort CARB: Sekundärluft-System" VALUE 0x014B04 RL_UWORD 0 CM_IDENT_UNIT_0 0.0 65535.0 /end CHARACTERISTIC
/begin CHARACTERISTIC CDKMD "Codewort Kunde: Aussetzer, Summenfehler (multiple)" VALUE 0x0147E8 RL_UWORD 0 CM_IDENT_UNIT_0 0.0 65535.0 /end CHARACTERISTIC
/begin CHARACTERISTIC CDCLASH "Codewort CARB:	Lambda-Sondenalterung hinter Kat." VALUE 0x0149E4 RL_UWORD 0 CM_IDENT_UNIT_0 0.0 65535.0 /end CHARACTERISTIC
/begin CHARACTERISTIC CDTDVEV "Codewort Tester: DV-E Fehler bei Verstärkerabgleich" VALUE 0x0148C4 RL_UWORD 0 CM_IDENT_UNIT_0 0.0 65535.0 /end CHARACTERISTIC
/begin CHARACTERISTIC CDTNWKW "Codewort Tester: Zuordnung Nockenwelle zu Kurbelwelle" VALUE 0x01481A RL_UWORD 0 CM_IDENT_UNIT_0 0.0 65535.0 /end CHARACTERISTIC
/begin CHARACTERISTIC CDKRKAZ2 "Codewort Kunde: Lambdaregelungsadaption Kraftstoff (Bank 2)" VALUE 0x01480E RL_UWORD 0 CM_IDENT_UNIT_0 0.0 65535.0 /end CHARACTERISTIC
/begin CHARACTERISTIC CDKRKAT "Codewort Kunde: LR- Adaption pro Zeit" VALUE 0x014808 RL_UWORD 0 CM_IDENT_UNIT_0 0.0 65535.0 /end CHARACTERISTIC
/begin CHARACTERISTIC CDCKAT "Codewort CARB:	Katalysator-Konvertierung" VALUE 0x01497C RL_UWORD 0 CM_IDENT_UNIT_0 0.0 65535.0 /end CHARACTERISTIC
/begin CHARACTERISTIC CDCCRA "Codewort CARB: EKP aus bei Crash" VALUE 0x0147E4 RL_UWORD 0 CM_IDENT_UNIT_0 0.0 65535.0 /end CHARACTERISTIC
/begin CHARACTERISTIC CDKFRAO2 "Codewort Kunde: LR- Adaption mult. oderer Bereich" VALUE 0x014CCC RL_UWORD 0 CM_IDENT_UNIT_0 0.0 65535.0 /end CHARACTERISTIC
/begin CHARACTERISTIC CDCTUM "Codewort CARB: Umgebungs(-luft)-Temperatur TUM" VALUE 0x014672 RL_UWORD 0 CM_IDENT_UNIT_0 0.0 65535.0 /end CHARACTERISTIC
/begin CHARACTERISTIC CDTKS2 "Codewort Tester: Klopfsensor 2" VALUE 0x01490E RL_UWORD 0 CM_IDENT_UNIT_0 0.0 65535.0 /end CHARACTERISTIC
/begin CHARACTERISTIC CDTKS1 "Codewort Tester: Klopfsensor 1" VALUE 0x01490C RL_UWORD 0 CM_IDENT_UNIT_0 0.0 65535.0 /end CHARACTERISTIC
/begin CHARACTERISTIC CWDTKWAV "Codewort Berücksichtigung Kühlwasser-Absperrventil für Diagnose" VALUE 0x019D9A RL_UBYTE 0 CM_IDENT_UNIT_0 0.0 255.0 /end CHARACTERISTIC
/begin CHARACTERISTIC CDKHSHE2 "Codewort Kunde: Enstufe Heizung Sonde Hinter Kat. Bank 2" VALUE 0x0147B0 RL_UWORD 0 CM_IDENT_UNIT_0 0.0 65535.0 /end CHARACTERISTIC
/begin CHARACTERISTIC CDKMDB "Codewort Kunde: Momentbegrenzung Sollmoment" VALUE 0x014802 RL_UWORD 0 CM_IDENT_UNIT_0 0.0 65535.0 /end CHARACTERISTIC
/begin CHARACTERISTIC CDCKPE "Codewort CARB: EKP-Relais Endstufe" VALUE 0x014994 RL_UWORD 0 CM_IDENT_UNIT_0 0.0 65535.0 /end CHARACTERISTIC
/begin CHARACTERISTIC TMFRATMN "minimale Temperatur bei der ftklra_w = 1 ist" VALUE 0x01A32D RL_UBYTE 0 CM_LIN_UNIT_94 -48.0 143.25 /end CHARACTERISTIC
/begin CHARACTERISTIC CDTDPL "Codewort Tester: Dauerplus" VALUE 0x0148AE RL_UWORD 0 CM_IDENT_UNIT_0 0.0 65535.0 /end CHARACTERISTIC
/begin CHARACTERISTIC KRVFN "Anz. Zünd./Zyl., bzw. Zeitangabe von Frühverst. zu Frühverst. (Stufenbreite-KR)" VALUE 0x01966D RL_UBYTE 0 CM_IDENT_UNIT_0 0.0 255.0 /end CHARACTERISTIC
/begin CHARACTERISTIC USRIUH "Untere Spannungs-Schwelle für Ri-Messung der Sonde hinter KAT" VALUE 0x014A56 RL_UWORD 0 CM_LIN_UNIT_96 -1.0 318.995 /end CHARACTERISTIC
/begin CHARACTERISTIC CDKDMTL "Codewort Kunde: Tankentlüftungssystem, Modulefehler (Hardware)" VALUE 0x014C8E RL_UWORD 0 CM_IDENT_UNIT_0 0.0 65535.0 /end CHARACTERISTIC
/begin CHARACTERISTIC DVZVRWA2 "Delta zw. Ziel- und Sollgeschw. für Übergang in WA-Lande-Mode Bereich 2" VALUE 0x01B194 RL_UWORD 0 CM_LIN_UNIT_29 0.0 511.9922 /end CHARACTERISTIC
/begin CHARACTERISTIC CDCPWMEKE " Codewort CARB:	 PWM-Signal  Endstufe EKP_SG" VALUE 0x014FCC RL_UWORD 0 CM_IDENT_UNIT_0 0.0 65535.0 /end CHARACTERISTIC
/begin CHARACTERISTIC VDASH "Mindestgeschwindigkeit für Dashpot" VALUE 0x011556 RL_UBYTE 0 CM_LIN_UNIT_97 0.0 318.75 /end CHARACTERISTIC
/begin CHARACTERISTIC CDTFRST2 "Codewort Tester: LR-Abweichung Bank 2" VALUE 0x0148F2 RL_UWORD 0 CM_IDENT_UNIT_0 0.0 65535.0 /end CHARACTERISTIC
/begin CHARACTERISTIC NMAXSWVS "Integratorsteigung NMAX-Steuerung Ventilhubsteuerung" VALUE 0x01689E RL_UWORD 0 CM_LIN_UNIT_98 0.0 1638375.0 /end CHARACTERISTIC
/begin CHARACTERISTIC CDTDVEU "Codewort Tester: DV-E Fehler beim UMA-Lernen" VALUE 0x0148BE RL_UWORD 0 CM_IDENT_UNIT_0 0.0 65535.0 /end CHARACTERISTIC
/begin CHARACTERISTIC FUKABAKI "Init.-Wert adaptiver ÜK-Korrekturfaktor BA für kalten Motor" VALUE 0x0114F2 RL_UBYTE 0 CM_LIN_UNIT_61 0.0 3.9844 /end CHARACTERISTIC
/begin CHARACTERISTIC CDKDMTKNM "Codewort Kunde: Kleinstleck, no MIL" VALUE 0x014C8C RL_UWORD 0 CM_IDENT_UNIT_0 0.0 65535.0 /end CHARACTERISTIC
/begin CHARACTERISTIC CWKBID "Codewort zur Ausgabe drehmomentmindernder Kriterien auf Kombi-Display" VALUE 0x010010 RL_UBYTE 0 CM_IDENT_UNIT_0 0.0 255.0 /end CHARACTERISTIC
/begin CHARACTERISTIC TVNWSAK "Umschaltverzögerung von RLNWSN auf RLNWSNK" VALUE 0x01139A RL_UBYTE 0 CM_LIN_UNIT_91 0.0 2.55 /end CHARACTERISTIC
/begin CHARACTERISTIC TSFLATP "Fehlersummenzeit: Lambda-Sondenalterung TP" VALUE 0x011511 RL_UBYTE 0 CM_IDENT_UNIT_0 0.0 255.0 /end CHARACTERISTIC
/begin CHARACTERISTIC TSFFST "Fehlersummenzeit: Tankfüllstand" VALUE 0x0114FB RL_UBYTE 0 CM_IDENT_UNIT_0 0.0 255.0 /end CHARACTERISTIC
/begin CHARACTERISTIC TVLLR "Einschaltverzögerung: B_llri bei Überdrehzahl" VALUE 0x010E2D RL_UBYTE 0 CM_LIN_UNIT_99 0.0 5.1 /end CHARACTERISTIC
/begin CHARACTERISTIC FIRNLIGN "Mindestwert für Winkelfehler nach der ersten Zündung" VALUE 0x01157A RL_UBYTE 0 CM_IDENT_UNIT_0 0.0 255.0 /end CHARACTERISTIC
/begin CHARACTERISTIC SRYLS "Schwelle für Readiness-Bildung Lambdasonden-Diagnose" VALUE 0x010B31 RL_UBYTE 0 CM_IDENT_UNIT_0 0.0 255.0 /end CHARACTERISTIC
/begin CHARACTERISTIC NVQUOT4O "Gangerkennung n/v 4 Gang oben" VALUE 0x014FFA RL_UWORD 0 CM_LIN_UNIT_29 0.0 511.9922 /end CHARACTERISTIC
/begin CHARACTERISTIC KSTA1INI "Initialisierungswert STADAP-Faktor in Bereich 1" VALUE 0x012648 RL_UBYTE 0 CM_LIN_UNIT_29 0.0 1.9922 /end CHARACTERISTIC
/begin CHARACTERISTIC DFSERES "Differenz der Adaptionswerte zum Auslösen eines Reset der fuel-on/-off adaption" VALUE 0x01003A RL_UBYTE 0 CM_LIN_UNIT_100 0.0 3.7353 /end CHARACTERISTIC
/begin CHARACTERISTIC DWPMDBGV "Delta Pedalwinkel zum Auslösen der geschw.-abh. Momentenaufbaubegrenzung" VALUE 0x01616A RL_SWORD 0 CM_LIN_UNIT_101 -100.0001 99.997 /end CHARACTERISTIC
/begin CHARACTERISTIC CLACGUMV "Fehlerklasse: EGS; Versorgungsspannung Magnetventile" VALUE 0x0106CF RL_UBYTE 0 CM_IDENT_UNIT_0 0.0 255.0 /end CHARACTERISTIC
/begin CHARACTERISTIC NLRSHB "Drehzahlschwelle, Abschalten LR bei Schub, in Verbindung mit LL und TLLRSHB" VALUE 0x0123F4 RL_UBYTE 0 CM_LIN_UNIT_102 0.0 10200.0 /end CHARACTERISTIC
/begin CHARACTERISTIC TWNWSE "Zeit nach Start bis zur ersten Berechnung von wnwem" VALUE 0x01231C RL_UBYTE 0 CM_LIN_UNIT_103 0.0 25.5 /end CHARACTERISTIC
/begin CHARACTERISTIC LRNST9_T "Wartezeit in Lernschritt 9" VALUE 0x0111C9 RL_UBYTE 0 CM_LIN_UNIT_99 0.0 5.1 /end CHARACTERISTIC
/begin CHARACTERISTIC DTIREL "Dti-Schwellwert für zweiten Nachspritzer" VALUE 0x0117DD RL_UBYTE 0 CM_LIN_UNIT_104 0.0 99.6094 /end CHARACTERISTIC
/begin CHARACTERISTIC IVDNDTE "LLR: I-Verstärkung bei DTEV" VALUE 0x011738 RL_UBYTE 0 CM_LIN_UNIT_105 0.0 0.6076 /end CHARACTERISTIC
/begin CHARACTERISTIC TDMLDMX "Entprellzeit Freigabe HFM-Diagnose nach Startende" VALUE 0x0112C1 RL_UBYTE 0 CM_LIN_UNIT_91 0.0 2.55 /end CHARACTERISTIC
/begin CHARACTERISTIC TSFTGET "Fehlersummenzeit: Getriebetemperatur" VALUE 0x010B13 RL_UBYTE 0 CM_IDENT_UNIT_0 0.0 255.0 /end CHARACTERISTIC
/begin CHARACTERISTIC TDKLAGDE "Zeitdelta für Fehlerzählerlöschung bei DK-Soll-/Istvergleich" VALUE 0x011CB2 RL_UBYTE 0 CM_LIN_UNIT_99 0.0 5.1 /end CHARACTERISTIC
/begin CHARACTERISTIC CWARMD "Codewort Antiruckelfunktion" VALUE 0x0118EE RL_UBYTE 0 CM_IDENT_UNIT_0 0.0 255.0 /end CHARACTERISTIC
/begin CHARACTERISTIC CWKHZW "Codewort für spätesten Zündwinkel bei Katheizen" VALUE 0x012BC8 RL_UBYTE 0 CM_IDENT_UNIT_0 0.0 255.0 /end CHARACTERISTIC
/begin CHARACTERISTIC CLADMTKNM "Fehlerklasse: Kleinstleck, no MIL" VALUE 0x0106DC RL_UBYTE 0 CM_IDENT_UNIT_0 0.0 255.0 /end CHARACTERISTIC
/begin CHARACTERISTIC LURFOST "Laufruhe-Referenzwert für stop fuel-on/-off Adaption, Vergleich mit lunw" VALUE 0x01006B RL_UBYTE 0 CM_LIN_UNIT_106 0.0 231.9215 /end CHARACTERISTIC
/begin CHARACTERISTIC AUFW10MS "AUFW10MS" VALUE 0x01240B RL_UBYTE 0 CM_LIN_UNIT_107 0.0 5100.0 /end CHARACTERISTIC
/begin CHARACTERISTIC TSFTMKI "Fehlersummenzeit: Motortemperatur aus Kombiinstrument TMKI" VALUE 0x011544 RL_UBYTE 0 CM_IDENT_UNIT_0 0.0 255.0 /end CHARACTERISTIC
/begin CHARACTERISTIC NRLIP_UM "Motordrehzahl-Schwelle für den rl/rlip-Vergleich in der Funktionsüberwachg" VALUE 0x017CF6 RL_UBYTE 0 CM_LIN_UNIT_102 0.0 10200.0 /end CHARACTERISTIC
/begin CHARACTERISTIC CWNWREF "Nockenwellenverhalten im Start" VALUE 0x010A0B RL_UBYTE 0 CM_IDENT_UNIT_0 0.0 255.0 /end CHARACTERISTIC
/begin CHARACTERISTIC ZASMASK "Zylinderabschaltmaske für CIFI aus ZAS" VALUE 0x01007D RL_UBYTE 0 CM_IDENT_UNIT_0 0.0 255.0 /end CHARACTERISTIC
/begin CHARACTERISTIC TVKOE "Verzögerungszeit für Kompressor EIN" VALUE 0x01310C RL_UBYTE 0 CM_LIN_UNIT_103 0.0 25.5 /end CHARACTERISTIC
/begin CHARACTERISTIC DMLLRMXN "Sicherheitskonzept: obere Begrenzung für dmllr" CURVE 0x011853 RL_UBYTE 0 CM_LIN_UNIT_104 0.0 99.6094
 /begin AXIS_DESCR COM_AXIS NO_INPUT_QUANTITY CM_LIN_nmot_25 6 0.0 10200.0 AXIS_PTS_REF AXIS_DMLLRMXN_X /end AXIS_DESCR
/end CHARACTERISTIC
/begin CHARACTERISTIC TVLLRPST "Zeitverzögerung nach Start zum Deaktivieren der P-Verstärkung im Start" VALUE 0x0118B3 RL_UBYTE 0 CM_LIN_UNIT_108 0.0 51.0 /end CHARACTERISTIC
/begin CHARACTERISTIC RL2DVSU "Diagnoseschwelle: Untere Last bei Ventilhub groß" VALUE 0x0123B8 RL_UBYTE 0 CM_LIN_UNIT_92 0.0 191.25 /end CHARACTERISTIC
/begin CHARACTERISTIC TDMSDKS "Zeitverzögerung bis das Bit B_fkmsdks wirksam wird" VALUE 0x011817 RL_UBYTE 0 CM_IDENT_UNIT_0 0.0 255.0 /end CHARACTERISTIC
/begin CHARACTERISTIC UBNACHL "Ub-Ersatzwert im Nachlauf" VALUE 0x015A96 RL_UWORD 0 CM_LIN_UNIT_109 0.0 1245.165 /end CHARACTERISTIC
/begin CHARACTERISTIC CDCSLV2 "Codewort CARB: Sekundärluftventil, Bank 2" VALUE 0x01501C RL_UWORD 0 CM_IDENT_UNIT_0 0.0 65535.0 /end CHARACTERISTIC
/begin CHARACTERISTIC TMH "Motortemperatur - Schwelle heiß" VALUE 0x0113AC RL_UBYTE 0 CM_LIN_UNIT_94 -48.0 143.25 /end CHARACTERISTIC
/begin CHARACTERISTIC ANZTP "Anzahl auszublendender Perioden für Periodendauerüberwachung" VALUE 0x0110E1 RL_UBYTE 0 CM_IDENT_UNIT_0 0.0 255.0 /end CHARACTERISTIC
/begin CHARACTERISTIC ZDVS "Entprellung Fehlereintrag Ventlihubsteuerung" VALUE 0x011B58 RL_UBYTE 0 CM_IDENT_UNIT_0 0.0 255.0 /end CHARACTERISTIC
/begin CHARACTERISTIC CLAFPP "Fehlerklasse: Poti Fahrpedal" VALUE 0x0106FA RL_UBYTE 0 CM_IDENT_UNIT_0 0.0 255.0 /end CHARACTERISTIC
/begin CHARACTERISTIC CDKSLS2 "Codewort Kunde: Sekundärluft-System Bank 2" VALUE 0x014816 RL_UWORD 0 CM_IDENT_UNIT_0 0.0 65535.0 /end CHARACTERISTIC
/begin CHARACTERISTIC CDKFRAU2 "Codewort Kunde: LR- Adaption mult. untere Schwelle Bank 2" VALUE 0x014CD0 RL_UWORD 0 CM_IDENT_UNIT_0 0.0 65535.0 /end CHARACTERISTIC
/begin CHARACTERISTIC CDTTM "Codewort Tester: TMOT" VALUE 0x014980 RL_UWORD 0 CM_IDENT_UNIT_0 0.0 65535.0 /end CHARACTERISTIC
/begin CHARACTERISTIC CDKHSV2 "Codewort Kunde:	Lambdasonden-Heizung vor Katalysator, Bank 2" VALUE 0x0147B4 RL_UWORD 0 CM_IDENT_UNIT_0 0.0 65535.0 /end CHARACTERISTIC
/begin CHARACTERISTIC CWZWVMX "Codewort Zündwinkeleingriff bei VMAX-Begrenzung" VALUE 0x01155A RL_UBYTE 0 CM_IDENT_UNIT_0 0.0 255.0 /end CHARACTERISTIC
/begin CHARACTERISTIC KSTAMN1 "Min-Begrenzung des STADAP-Faktors in Bereich 1" VALUE 0x011502 RL_UBYTE 0 CM_LIN_UNIT_29 0.0 1.9922 /end CHARACTERISTIC
/begin CHARACTERISTIC CDKKROF "Codewort Kunde:	Klopfregelung Offset" VALUE 0x0147BC RL_UWORD 0 CM_IDENT_UNIT_0 0.0 65535.0 /end CHARACTERISTIC
/begin CHARACTERISTIC ZLRHML2 "Luftmassendurchsatz abhängige Zeitkonstante für Lambdaregler h. Kat. Bank 2" VALUE 0x0117CE RL_UBYTE 0 CM_LIN_UNIT_110 0.0 9.9609 /end CHARACTERISTIC
/begin CHARACTERISTIC DMLSDUG "Delta Moment Ende Lastschlagdämpfung" CURVE 0x01619E RL_UWORD 0 CM_LIN_UNIT_111 0.0 99.9985 /begin AXIS_DESCR FIX_AXIS NO_INPUT_QUANTITY CM_IDENT_UNIT_0 3 0 2 /end AXIS_DESCR /end CHARACTERISTIC
/begin CHARACTERISTIC CLADVEE "Fehlerklasse: DV-E Endstufe" VALUE 0x0162DB RL_UBYTE 0 CM_IDENT_UNIT_0 0.0 255.0 /end CHARACTERISTIC
/begin CHARACTERISTIC FMFKR "Mittenfrequenz für Bandpaßfilter Klopfregelung" VALUE 0x01900B RL_UBYTE 0 CM_IDENT_UNIT_0 0.0 255.0 /end CHARACTERISTIC
/begin CHARACTERISTIC DLURVS "Drehzahlabh. Laufunruhe-Referenz-Minimalwert für Ventilhubst." VALUE 0x01181B RL_SBYTE 0 CM_LIN_UNIT_106 -116.4155 115.506 /end CHARACTERISTIC
/begin CHARACTERISTIC FQFSTT "Quantisierungsfaktor Fuellstand" VALUE 0x010A4B RL_UBYTE 0 CM_LIN_UNIT_103 0.0 25.5 /end CHARACTERISTIC
/begin CHARACTERISTIC DWNWES "Schwellenwert zur Aktivierung der Krafstoffkorrektur durch NWS" VALUE 0x010F1E RL_UBYTE 0 CM_LIN_UNIT_112 0.0 127.5 /end CHARACTERISTIC
/begin CHARACTERISTIC DZWSTTA "Delta Zündwinkel im Start" CURVE 0x0194FD RL_SBYTE 0 CM_LIN_UNIT_92 -96.0 95.25 /begin AXIS_DESCR FIX_AXIS NO_INPUT_QUANTITY CM_IDENT_UNIT_0 3 0 2 /end AXIS_DESCR /end CHARACTERISTIC
/begin CHARACTERISTIC DZWMNSTN "Drehzahlabhängiger Offset auf den spätesten Zündwinkel  wr. Startüberschwingers" CURVE 0x019263 RL_SBYTE 0 CM_LIN_UNIT_92 -96.0 95.25 /begin AXIS_DESCR FIX_AXIS NO_INPUT_QUANTITY CM_IDENT_UNIT_0 3 0 2 /end AXIS_DESCR /end CHARACTERISTIC
/begin CHARACTERISTIC FRINH1 "Multiplikativer Faktor für RIN Sollwert hinter Kat" CURVE 0x01182F RL_UBYTE 0 CM_LIN_UNIT_113 0.0 63.75
 /begin AXIS_DESCR COM_AXIS NO_INPUT_QUANTITY CM_LIN_tkatmf_26 5 -50.0 1225.0 AXIS_PTS_REF AXIS_FRINH1_X /end AXIS_DESCR
/end CHARACTERISTIC
/begin CHARACTERISTIC IPA_T_UM "Fehlertoleranzzeit für unteren DK-Anschlag im ungültigen Bereich f. d. Fktüberw." VALUE 0x019685 RL_UBYTE 0 CM_LIN_UNIT_102 0.0 10200.0 /end CHARACTERISTIC
/end MODULE
/end PROJECT
